## components/applications/apps-bootloader/source/Kconfig
```kconfig
menuconfig CONFIG_BOOT_SELFCOMPRESSED
	bool "Support bootloader self compressed"
	default n

if CONFIG_BOOT_SELFCOMPRESSED

choice
	prompt "Bootloader self compress algo"
	default CONFIG_BOOT_SELFCOMPRESSED_LZMA

	config CONFIG_BOOT_SELFCOMPRESSED_LZMA
		bool "Bootloader lzma self-compressed"

	config CONFIG_BOOT_SELFCOMPRESSED_LZO1X
		bool "Bootloader lzo1x self-compressed"
endchoice

endif

config CONFIG_BOOT_SHOWLOGO
	bool "Support boot show logo/av"
	default y
	help
	  This feature depends on audio/video driver support in hcrtos kernel.
	  If the is no audio/video driver enabled, the audio or video or both
	  will be ignored.

config CONFIG_BOOT_HDMI_TX_CHECK_EDID
	bool "Support edid detection"
	default n
	help
	  edid detection

choice
	prompt "Firmware Solution"
	default CONFIG_BOOT_HCRTOS

	config CONFIG_BOOT_HCRTOS
		bool "Boot hcrtos firmware"

	config CONFIG_BOOT_HCLINUX_DUALCORE
		bool "Boot hclinux dual-core firmware"

	config CONFIG_BOOT_HCLINUX_SINGLECORE
		bool "Boot hclinux single-core firmware"

	config CONFIG_BOOT_NONE
		bool "No firmware to boot"
endchoice

config CONFIG_BOOT_SHOWMEMINFO
	bool "Support show memory info"
	default y
	help
	  Show memory info in console

menuconfig CONFIG_BOOT_USBD_UPGRADE
	bool "Support usbd upgrade "
	select CONFIG_DRVR_RAMDISK
	select BR2_PACKAGE_PREBUILTS_USBGADGETDRIVER
	select CONFIG_BOOT_SHOW_UPGRADE_WAY
	default n

if CONFIG_BOOT_USBD_UPGRADE
config CONFIG_BOOT_USBD_UPGRADE_REQUEST_TIME
	int "usbd upgrade request time "
	range 0 5
	default 3

config CONFIG_BOOT_USBD_UPGRADE_USBD_PORT_NUM
	int "select which port to usbd upgrade"
	range 0 1
	default 0

choice
	prompt "Select enter usbd upgrade way"
	default CONFIG_BOOT_USBD_UPGRADE_ENTER_BY_CHAR

	config  CONFIG_BOOT_USBD_UPGRADE_ENTER_BY_CHAR
		bool "press any char in keyboard"

	config  CONFIG_BOOT_USBD_UPGRADE_ENTER_BY_KEY
		bool "press physical key in board"
endchoice
endif


menuconfig CONFIG_BOOT_UPGRADE
	bool "Support upgrade"
	select BR2_PACKAGE_HCFOTA
	select CONFIG_BOOT_SHOW_UPGRADE_WAY
	default y
	help
	  Support upgrade in bootloader

if CONFIG_BOOT_UPGRADE
config CONFIG_BOOT_UPGRADE_MODE
	bool "Support upgrade mode"
	default n
	help
	  Support upgrade mode in bootloader

if CONFIG_BOOT_UPGRADE_MODE
config CONFIG_BOOT_UPGRADE_SUPPORT_USBDEVICE
	bool "Support usbdevice"
	depends on CONFIG_BOOT_USBD_UPGRADE
	default n

config CONFIG_BOOT_UPGRADE_SUPPORT_USBHOST
	bool "Support usbhost"
	default n

config CONFIG_BOOT_UPGRADE_SUPPORT_SD
	bool "Support sd card"
	default n

config CONFIG_BOOT_UPGRADE_SUPPORT_NETWORK
	bool "Support network"
	default n

config CONFIG_BOOT_HCFOTA_TIMEOUT
	int "usbd upgrade request time "
	range 0 60000
	default 10000

endif

config CONFIG_BOOT_UPGRADE_EXTERNAL_FLASH
	bool "external flash distribution"
	default n
	help
	  Support upgrade mode in bootloader

if CONFIG_BOOT_UPGRADE_EXTERNAL_FLASH
choice
	prompt "external flash type"
	default CONFIG_BOOT_UPGRADE_EXTERNAL_FLASH_EMMC

	config CONFIG_BOOT_UPGRADE_EXTERNAL_FLASH_EMMC
		bool "emmc"

	config CONFIG_BOOT_UPGRADE_EXTERNAL_FLASH_NAND
		bool "nand flash"

	config CONFIG_BOOT_UPGRADE_EXTERNAL_FLASH_SDCARD
		bool "sd card"

endchoice
endif

endif

menuconfig CONFIG_BOOT_SHOW_UPGRADE_WAY
	bool "progress bar menu"
	default n

if  CONFIG_BOOT_SHOW_UPGRADE_WAY

choice
	prompt "show progress bar way during upgrade firmware"
	default CONFIG_BOOT_UPGRADE_SHOW_WITH_SERIAL

	config CONFIG_BOOT_UPGRADE_SHOW_WITH_SCREEN
		bool "The screen displays a progress bar"
		select CONFIG_MMAP
		select CONFIG_DRV_VIDEO
		select CONFIG_DRV_HCFB

	config CONFIG_BOOT_UPGRADE_SHOW_WITH_SERIAL
		bool "Serial port printing progress bar"

	config CONFIG_BOOT_UPGRADE_SHOW_WITH_LED
		bool "Show progress bar with led"

endchoice

endif 

choice
       prompt "Select the location where the system start up"
       default CONFIG_BOOT_STARTUP_FROM_FLASH

       config  CONFIG_BOOT_STARTUP_FROM_FLASH
               bool "flash"

       config  CONFIG_BOOT_STARTUP_FROM_EMMC_SD
               bool "emmc/sd"
endchoice

config CONFIG_BOOT_STANDBY
	bool "Support boot standby"
	default n
	help
	  This function depends on the standby function in the hcrtos kernel.
	  If the standby function is not enabled, the function cannot take effect.

menuconfig CONFIG_BOOT_BACKLIGHT
	bool "Support boot open lcd backlight"
	default y
	help
		open lcd backlight

if CONFIG_BOOT_BACKLIGHT
config CONFIG_BOOT_BACKLIGHT_DELAY_TIME
    int "Time for boot to turn on backlight, in milliseconds"
    range 0 10000
    default 0

config CONFIG_BOOT_PWM_BACKLIGHT_MONITOR
    bool "Backlight monitor function"
    default n
	help
		add backlight detection function

config CONFIG_BOOT_BLUETOOTH_BACKLIGHT
    bool "Bluetooth open gpio backlight"
    default n
	help
		Set bluetooth open gpio backlight

endif

config CONFIG_BOOT_PQ_START
	bool "Support boot open pq start"
	default n
	depends on CONFIG_SOC_HC16XX
	help
		open pq start

config CONFIG_BOOT_UPGRADE_FAILED_FORCE_UPGRADE
	bool "Support force upgrade after upgrade fails"
	default n
	help
		When the bootm cannot find the image, force the upgrade

config CONFIG_BOOT_LCD
	bool "Support boot open lcd"
	default y
	help
		Open lcddev for lcddev initialization
```

## components/applications/apps-hccast-samplecode/Kconfig
```kconfig
menuconfig BR2_PACKAGE_APPS_HCCAST_SAMPLECODE
	bool "hccast-sample"

if BR2_PACKAGE_APPS_HCCAST_SAMPLECODE
source "source/Kconfig"
endif
```

## components/applications/apps-hccast/Kconfig
```kconfig
menuconfig BR2_PACKAGE_APPS_HCCAST
	bool "hccast"
	select BR2_PACKAGE_PREBUILTS_LIBGE
	select BR2_PACKAGE_LIBLVGL
	select BR2_PACKAGE_HCFOTA

if BR2_PACKAGE_APPS_HCCAST
source "source/Kconfig"
endif
```

## components/applications/apps-hcdemo/Kconfig
```kconfig
menuconfig BR2_PACKAGE_APPS_HCDEMO
	bool "hcdemo"
	select BR2_PACKAGE_PREBUILTS_LIBGE
	select BR2_PACKAGE_LIBLVGL
	select BR2_PACKAGE_HCFOTA
	select BR2_PACKAGE_BLUETOOTH

if BR2_PACKAGE_APPS_HCDEMO
source "source/Kconfig"
endif
```

## components/applications/apps-hcscreen-p1/Kconfig
```kconfig
menuconfig BR2_PACKAGE_APPS_HCSCREEN_P1
	bool "hcscreen-p1"
	select BR2_PACKAGE_PREBUILTS_LIBGE
	select BR2_PACKAGE_LIBLVGL
	select BR2_PACKAGE_HCFOTA
	select BR2_PACKAGE_HCCAST
```

## components/applications/apps-hcscreen-p2/Kconfig
```kconfig
menuconfig BR2_PACKAGE_APPS_HCSCREEN_P2
	bool "hcscreen-p2"
	select BR2_PACKAGE_PREBUILTS_LIBGE
	select BR2_PACKAGE_LIBLVGL
	select BR2_PACKAGE_HCFOTA
	select BR2_PACKAGE_HCCAST
```

## components/applications/apps-hcscreen/Kconfig
```kconfig
menuconfig BR2_PACKAGE_APPS_HCSCREEN
	bool "hcscreen"
	select BR2_PACKAGE_PREBUILTS_LIBGE
	select BR2_PACKAGE_LIBLVGL
	select BR2_PACKAGE_HCFOTA
	select BR2_PACKAGE_HCCAST

if BR2_PACKAGE_APPS_HCSCREEN
source "source/Kconfig"
endif
```

## components/applications/apps-hcusbcast/Kconfig
```kconfig
menuconfig BR2_PACKAGE_APPS_HCUSBCAST
	bool "hcusbcast"
	select BR2_PACKAGE_PREBUILTS_LIBGE
	select BR2_PACKAGE_LIBLVGL
	select BR2_PACKAGE_HCFOTA
	select BR2_PACKAGE_HCCAST

if BR2_PACKAGE_APPS_HCUSBCAST
source "source/Kconfig"
endif
```

## components/applications/apps-hcusbcast/source/Kconfig
```kconfig
if BR2_PACKAGE_APPS_HCUSBCAST

config CONFIG_APPS_USBMIRROR
	bool "Enable USBMirror"
	default n
	select CONFIG_NET
	select BR2_PACKAGE_LIBOPENSSL
	select BR2_PACKAGE_LIBUSB
	select BR2_PACKAGE_HCCAST
	select BR2_PACKAGE_HCCAST_USBMIRROR
	
endif
```

## components/applications/apps-hdmiswitch/Kconfig
```kconfig
menuconfig BR2_PACKAGE_APPS_HDMISWITCH
	bool "hdmi switch"

if BR2_PACKAGE_APPS_HDMISWITCH
source "source/Kconfig"
endif
```

## components/applications/apps-kidev/Kconfig
```kconfig
menuconfig BR2_PACKAGE_APPS_KIDEV
	bool "kidev"
	select BR2_PACKAGE_PREBUILTS_LIBGE
	select BR2_PACKAGE_LIBLVGL
	select BR2_PACKAGE_PREBUILTS_LIBLRBALANCE
	select BR2_PACKAGE_PREBUILTS_LIBTWOTONE
	select BR2_PACKAGE_PREBUILTS_SPECTRUM

if BR2_PACKAGE_APPS_KIDEV

config CONFIG_APPS_PROJECTOR_HDMIIN
	bool "Enable HDMI IN"
	default n
	select BR2_PACKAGE_PREBUILTS_HDMIRX	

config CONFIG_APPS_PROJECTOR_CVBSIN
	bool "Enable CVBS IN"
	default n
	select CONFIG_VIDEO_TVDECODER_SUPPORT
	
config CONFIG_APPS_PROJECTOR_USBMIRROR
	bool "Enable USBMirror"
	default n
	select CONFIG_NET
	select BR2_PACKAGE_LIBOPENSSL
	select BR2_PACKAGE_LIBUSB
	select BR2_PACKAGE_HCCAST
	select BR2_PACKAGE_HCCAST_USBMIRROR

config CONFIG_APPS_PROJECTOR_WIRELESSCAST
	bool "Enable WirelessCast(miracast/dlna/airmirror)"
	default n
	select BR2_PACKAGE_HCCAST		
	select CONFIG_NET
	select BR2_PACKAGE_LIBOPENSSL
	select BR2_PACKAGE_CJSON
	select BR2_PACKAGE_PREBUILTS_LIBDSC
	select BR2_PACKAGE_PREBUILTS_RTL8188FU
	select BR2_PACKAGE_PREBUILTS_WPA_SUPPLICANT
	select BR2_PACKAGE_PREBUILTS_WIFI_WIRELESS_TOOLS
	select BR2_PACKAGE_LIBUSB 
	select BR2_PACKAGE_PREBUILTS_AACELDEC 
	select BR2_PACKAGE_HCCAST_WIRELESS 
	
config CONFIG_APPS_PROJECTOR_BLUETOOTH
	bool "Enable Bluetooth"
	default n
	depends on BR2_PACKAGE_BLUETOOTH
	help
		open BT according to your board used.
config CONFIG_APPS_PROJECTOR_VMOTOR_DRIVE
	bool "Support projector vmotor drive"
	default n
	help
		open step motor drive.

config CONFIG_APPS_PROJECTOR_SPDIF_OUT
	bool "Support projector spdif out"
	default y
	help
		open spdif out.

config CONFIG_APPS_PROJECTOR_MAIN_PAGE
	bool "Support Main(home) page"
	default n
	help
		open main page.

config CONFIG_APPS_PROJECTOR_CVBS_AUDIO_I2SI_I2SO
	bool "Support projector cvbs audio i2si i2so"
	default n
	help
		set cvbs audio i2si i2so out.

endif
```

## components/applications/apps-projector/Kconfig
```kconfig
menuconfig BR2_PACKAGE_APPS_PROJECTOR
	bool "projector"
	select BR2_PACKAGE_PREBUILTS_LIBGE
	select BR2_PACKAGE_LIBLVGL
	select BR2_PACKAGE_PREBUILTS_LIBLRBALANCE
	select BR2_PACKAGE_PREBUILTS_LIBTWOTONE
	select BR2_PACKAGE_PREBUILTS_SPECTRUM

if BR2_PACKAGE_APPS_PROJECTOR
source "source/Kconfig"
endif
```

## components/applications/apps-projector/source/Kconfig
```kconfig
if BR2_PACKAGE_APPS_PROJECTOR

config CONFIG_APPS_PROJECTOR_HDMIIN
	bool "Enable HDMI IN"
	default y
	select BR2_PACKAGE_PREBUILTS_HDMIRX	

config CONFIG_APPS_PROJECTOR_CVBSIN
	bool "Enable CVBS IN"
	default y
	select CONFIG_VIDEO_TVDECODER_SUPPORT
	
config CONFIG_APPS_PROJECTOR_USBMIRROR
	bool "Enable USBMirror"
	default n
	select CONFIG_NET
	select BR2_PACKAGE_LIBOPENSSL
	select BR2_PACKAGE_LIBUSB
	select BR2_PACKAGE_HCCAST
	select BR2_PACKAGE_HCCAST_USBMIRROR

config CONFIG_APPS_PROJECTOR_WIRELESSCAST
	bool "Enable WirelessCast(miracast/dlna/airmirror)"
	default n
	select BR2_PACKAGE_HCCAST		
	select CONFIG_NET
	select BR2_PACKAGE_LIBOPENSSL
	select BR2_PACKAGE_CJSON
	select BR2_PACKAGE_PREBUILTS_LIBDSC
	#select BR2_PACKAGE_PREBUILTS_RTL8188FU
	select BR2_PACKAGE_PREBUILTS_WPA_SUPPLICANT
	select BR2_PACKAGE_PREBUILTS_WIFI_WIRELESS_TOOLS
	select BR2_PACKAGE_LIBUSB 
	select BR2_PACKAGE_PREBUILTS_AACELDEC 
	select BR2_PACKAGE_HCCAST_WIRELESS 
	
config CONFIG_APPS_PROJECTOR_BLUETOOTH
	bool "Enable Bluetooth"
	default n
	depends on BR2_PACKAGE_BLUETOOTH
	help
		open BT according to your board used.
config CONFIG_APPS_PROJECTOR_VMOTOR_DRIVE
	bool "Support projector vmotor drive"
	default n
	help
		open step motor drive.

config CONFIG_APPS_PROJECTOR_SPDIF_OUT
	bool "Support projector spdif out"
	default n
	help
		open spdif out.

config CONFIG_APPS_PROJECTOR_SYS_ZOOM
	bool "Enable system zoom"
	default n 
	help
		open sys zoom

config CONFIG_APPS_PROJECTOR_USB_AUTO_UPGRADE
	bool "Enable usb auto upgrade"
	default n 
	help
		open open usb auto upgrade

config CONFIG_APPS_PROJECTOR_MAIN_PAGE
	bool "Support Main(home) page"
	default y
	help
		open main page.

config CONFIG_APPS_PROJECTOR_CVBS_AUDIO_I2SI_I2SO
	bool "Support projector cvbs audio i2si i2so"
	default y
	help
		set cvbs audio i2si i2so out.
		
config CONFIG_APPS_PROJECTOR_CAST_720P
	bool "Support 720p cast"
	default n
	help
		720p cast in 64M solution.

config CONFIG_APPS_PROJECTOR_BACKLIGHT_MONITOR
	bool "support backlight monitor"
	default n
	help
		support backlight monitor.

config CONFIG_APPS_PROJECTOR_KEYSTONE
	bool "support keystone"
	default n
	depends on CONFIG_SOC_HC16XX
	help
		support projector keystone function.

config CONFIG_APPS_PROJECTOR_LVGL_RESOLUTION_240P
    	bool "Support LVGL(osd) resolution for 240P"
    	default n
     	help
        reset LVGL resolution for 320 *240.

config CONFIG_APPS_PROJECTOR_LVGL_MBOX_STANDBY
	bool "Press POWER 2 times enter standby?"
	default n
	help
		Support confirm when you go in standby

endif
```

## components/applications/apps-sf2000/Kconfig
```kconfig
menuconfig BR2_PACKAGE_APPS_SF2000
	bool "sf2000"
	select BR2_PACKAGE_PREBUILTS_LIBGE
	select BR2_PACKAGE_LIBLVGL

if BR2_PACKAGE_APPS_SF2000
source "source/Kconfig"
endif
```

## components/applications/apps-spinandwr/Kconfig
```kconfig
menuconfig BR2_PACKAGE_APPS_SPINANDWR
	bool "spinand writer"

if BR2_PACKAGE_APPS_SPINANDWR
source "source/Kconfig"
endif
```

## components/applications/apps-spinandwr/source/Kconfig
```kconfig
menuconfig CONFIG_SPINANDWR_SELFCOMPRESSED
	bool "Support spinandwr self compressed"
	default n

if CONFIG_SPINANDWR_SELFCOMPRESSED

choice
	prompt "Spinandwr self compress algo"
	default CONFIG_SPINANDWR_SELFCOMPRESSED_LZMA

	config CONFIG_SPINANDWR_SELFCOMPRESSED_LZMA
		bool "Spinandwr lzma self-compressed"

	config CONFIG_SPINANDWR_SELFCOMPRESSED_LZO1X
		bool "Spinandwr lzo1x self-compressed"
endchoice

endif
```

## components/applications/apps-xbmp5/Kconfig
```kconfig
menuconfig BR2_PACKAGE_APPS_XBMP5
	bool "xbmp5"
	select BR2_PACKAGE_PREBUILTS_LIBGE
	select BR2_PACKAGE_LIBLVGL
	select BR2_PACKAGE_PREBUILTS_SPECTRUM

if BR2_PACKAGE_APPS_XBMP5

config CONFIG_APPS_PROJECTOR_WIRELESSCAST
	bool "Enable WirelessCast(miracast/dlna/airmirror)"
	default y
	select BR2_PACKAGE_HCCAST		
	select CONFIG_NET
	select BR2_PACKAGE_LIBOPENSSL
	select BR2_PACKAGE_CJSON
	select BR2_PACKAGE_PREBUILTS_LIBDSC
	select BR2_PACKAGE_PREBUILTS_RTL8188FU
	select BR2_PACKAGE_PREBUILTS_WPA_SUPPLICANT
	select BR2_PACKAGE_PREBUILTS_WIFI_WIRELESS_TOOLS
	select BR2_PACKAGE_LIBUSB 
	select BR2_PACKAGE_PREBUILTS_AACELDEC 
	select BR2_PACKAGE_HCCAST_WIRELESS 


config CONFIG_APPS_PROJECTOR_SYS_ZOOM
	bool "Enable system zoom"
	default n 
	help
		open sys zoom
		
config CONFIG_APPS_PROJECTOR_LVGL_MBOX_STANDBY
	bool "Press POWER 2 times enter standby?"
	default n
	help
		Support confirm when you go in standby
endif
```
