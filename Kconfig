## Kconfig
```kconfig
mainmenu "HCRTOS SDK Menu Configure"

source "target/Kconfig"

menu "Mirrors and Download locations"

config BR2_HAVE_DOT_CONFIG
	bool
	default y

config BR2_PRIMARY_SITE
	string "Primary download site"
	default ""
	help
	  Primary site to download from. If this option is set then
	  buildroot will try to download package source first from this
	  site and try the default if the file is not found.
	  Valid URIs are:
	    - URIs recognized by $(WGET)
	    - local URIs of the form file://absolutepath
	    - scp URIs of the form scp://[user@]host:path.

config BR2_PRIMARY_SITE_ONLY
	bool "Only allow downloads from primary download site"
	depends on BR2_PRIMARY_SITE != ""
	help
	  If this option is enabled, downloads will only be attempted
	  from the primary download site. Other locations, like the
	  package's official download location or the backup download
	  site, will not be considered. Therefore, if the package is not
	  present on the primary site, the download fails.

	  This is useful for project developers who want to ensure that
	  the project can be built even if the upstream tarball
	  locations disappear.

if !BR2_PRIMARY_SITE_ONLY

config BR2_BACKUP_SITE
	string "Backup download site"
	default "http://sources.buildroot.net"
	help
	  Backup site to download from. If this option is set then
	  buildroot will fall back to download package sources from here
	  if the normal location fails.

config BR2_KERNEL_MIRROR
	string "Kernel.org mirror"
	default "https://cdn.kernel.org/pub"
	help
	  kernel.org is mirrored on a number of servers around the
	  world. The following allows you to select your preferred
	  mirror. By default, a CDN is used, which automatically
	  redirects to a mirror geographically close to you.

	  Have a look on the kernel.org site for a list of mirrors, then
	  enter the URL to the base directory. Examples:

	     http://www.XX.kernel.org/pub (XX = country code)
	     http://mirror.aarnet.edu.au/pub/ftp.kernel.org

config BR2_GNU_MIRROR
	string "GNU Software mirror"
	default "http://ftpmirror.gnu.org"
	help
	  GNU has multiple software mirrors scattered around the
	  world. The following allows you to select your preferred
	  mirror. By default, a generic address is used, which
	  automatically selects an up-to-date and local mirror.

	  Have a look on the gnu.org site for a list of mirrors, then
	  enter the URL to the base directory. Examples:

	     http://ftp.gnu.org/pub/gnu
	     http://mirror.aarnet.edu.au/pub/gnu

config BR2_LUAROCKS_MIRROR
	string "LuaRocks mirror"
	default "http://rocks.moonscript.org"
	help
	  LuaRocks repository.

	  See http://luarocks.org

config BR2_CPAN_MIRROR
	string "CPAN mirror (Perl packages)"
	default "http://cpan.metacpan.org"
	help
	  CPAN (Comprehensive Perl Archive Network) is a repository of
	  Perl packages. It has multiple software mirrors scattered
	  around the world. This option allows you to select a mirror.

	  The list of mirrors is available at:
	  http://search.cpan.org/mirror

endif

config BR2_GLOBAL_PATCH_DIR
	string "global patch directories"
	help
	  You may specify a space separated list of one or more directories
	  containing global package patches. For a specific version
	  <packageversion> of a specific package <packagename>, patches are
	  applied as follows:

	  First, the default Buildroot patch set for the package is applied
	  from the package's directory in Buildroot.

	  Then for every directory - <global-patch-dir> - that exists in
	  BR2_GLOBAL_PATCH_DIR, if the directory
	  <global-patch-dir>/<packagename>/<packageversion>/ exists, then all
	  *.patch files in this directory will be applied.

	  Otherwise, if the directory <global-patch-dir>/<packagename> exists,
	  then all *.patch files in the directory will be applied.

endmenu

menu "Build options"

menu "Commands"

config BR2_WGET
	string "Wget command"
	default "wget --passive-ftp -nd -t 3"

config BR2_SVN
	string "Subversion (svn) command"
	default "svn --non-interactive"

config BR2_BZR
	string "Bazaar (bzr) command"
	default "bzr"

config BR2_GIT
	string "Git command"
	default "git"

config BR2_CVS
	string "CVS command"
	default "cvs"

config BR2_LOCALFILES
	string "Local files retrieval command"
	default "cp"

config BR2_SCP
	string "Secure copy (scp) command"
	default "scp"

config BR2_HG
	string "Mercurial (hg) command"
	default "hg"

config BR2_ZCAT
	string "zcat command"
	default "gzip -d -c"
	help
	  Command to be used to extract a gzip'ed file to stdout. zcat
	  is identical to gunzip -c except that the former may not be
	  available on your system.
	  Default is "gzip -d -c"
	  Other possible values include "gunzip -c" or "zcat".

config BR2_BZCAT
	string "bzcat command"
	default "bzcat"
	help
	  Command to be used to extract a bzip2'ed file to stdout.
	  bzcat is identical to bunzip2 -c except that the former may
	  not be available on your system.
	  Default is "bzcat"
	  Other possible values include "bunzip2 -c" or "bzip2 -d -c".

config BR2_XZCAT
	string "xzcat command"
	default "xzcat"
	help
	  Command to be used to extract a xz'ed file to stdout.
	  Default is "xzcat"

config BR2_LZCAT
	string "lzcat command"
	default "lzip -d -c"
	help
	  Command to be used to extract a lzip'ed file to stdout.
	  Default is "lzip -d -c"

config BR2_TAR_OPTIONS
	string "Tar options"
	default ""
	help
	  Options to pass to tar when extracting the sources.
	  E.g. " -v --exclude='*.svn*'" to exclude all .svn internal
	  files and to be verbose.

endmenu

choice
	bool "libraries"
	default BR2_STATIC_LIBS
	help
	  Select the type of libraries you want to use on the target.

	  The default is to build dynamic libraries and use those on the
	  target filesystem, except when the architecture and/or the
	  selected binary format does not support shared libraries.

config BR2_STATIC_LIBS
	bool "static only"
	help
	  Build and use only static libraries. No shared libraries will
	  be installed on the target. This potentially increases your
	  code size and should only be used if you know what you are
	  doing. Note that some packages may not be available when this
	  option is enabled, due to their need for dynamic library
	  support.

endchoice

endmenu

menu "Toolchain"

config BR2_TARGET_CROSS
	string "target cross compiler"

config BR2_JLEVEL
	int "Number of jobs to run simultaneously (0 for auto)"
	default "0"
	help
	  Number of jobs to run simultaneously.  If 0, determine
	  automatically according to number of CPUs on the host
	  system.

config BR2_TARGET_CFLAGS
	string "target cflags"

config BR2_TARGET_CXXFLAGS
	string "target cxxflags"

config BR2_TARGET_LDFLAGS
	string "target ldflags"

endmenu

menu "System configuration"
config BR2_EXTERNAL_PRODUCT_NAME
	string "product name"
	help
	  The product name

config BR2_EXTERNAL_BOARD_DDRINIT_FILE
	string "DDRinit file"
	help
	  Path of DDR init file

config BR2_EXTERNAL_BOOTMEDIA_FILE
	string "bootmedia file"
	help
	  Path of bootmedia file
	  
config BR2_EXTERNAL_HRXKEY
	string "hrx key file"
	help
	  Path of hrx file

choice
	prompt "boot type"
	default BR2_EXTERNAL_BOOT_TYPE_SPINOR

config BR2_EXTERNAL_BOOT_TYPE_SPINOR
	bool "spi nor boot"

config BR2_EXTERNAL_BOOT_TYPE_SPINAND
	bool "spi nand boot"
endchoice

if BR2_EXTERNAL_BOOT_TYPE_SPINAND

choice
	prompt "SPINAND pagesize"
	default CONFIG_MTD_SPINAND_PAGESIZE_2KB

config CONFIG_MTD_SPINAND_PAGESIZE_2KB
	bool "2kB"

config CONFIG_MTD_SPINAND_PAGESIZE_4KB
	bool "4kB"

endchoice

config CONFIG_MTD_SPINAND_PAGESIZE
	hex
	default "0x00000800" if CONFIG_MTD_SPINAND_PAGESIZE_2KB
	default "0x00001000" if CONFIG_MTD_SPINAND_PAGESIZE_4KB

choice
	prompt "SPINAND erasesize"
	default CONFIG_MTD_SPINAND_ERASESIZE_128KB

config CONFIG_MTD_SPINAND_ERASESIZE_64KB
	bool "64kB"

config CONFIG_MTD_SPINAND_ERASESIZE_128KB
	bool "128kB"

config CONFIG_MTD_SPINAND_ERASESIZE_256KB
	bool "256kB"

endchoice

config CONFIG_MTD_SPINAND_ERASESIZE
	hex
	default "0x00010000" if CONFIG_MTD_SPINAND_ERASESIZE_64KB
	default "0x00020000" if CONFIG_MTD_SPINAND_ERASESIZE_128KB
	default "0x00040000" if CONFIG_MTD_SPINAND_ERASESIZE_256KB
endif

choice
       prompt "Firmware compress algo"
       default BR2_EXTERNAL_FW_COMPRESS_GZIP

config BR2_EXTERNAL_FW_COMPRESS_GZIP
       bool "gzip"

config BR2_EXTERNAL_FW_COMPRESS_LZMA
       bool "lzma"
       select CONFIG_LIB_LZMA

config BR2_EXTERNAL_FW_COMPRESS_LZO1X
       bool "lzo1x"
       select BR2_PACKAGE_LIBLZO
       select BR2_PACKAGE_HOST_LZO1X

config BR2_EXTERNAL_FW_COMPRESS_NONE
       bool "none"

endchoice

config BR2_ROOTFS_POST_BUILD_SCRIPT
	string "Custom scripts to run before creating filesystem images"
	default ""
	help
	  Specify a space-separated list of scripts to be run after the
	  build has finished and before Buildroot starts packing the
	  files into selected filesystem images.

	  This gives users the opportunity to do board-specific
	  cleanups, add-ons and the like, so the generated files can be
	  used directly without further processing.

	  These scripts are called with the target directory name as
	  first argument. Make sure the exit code of those scripts are
	  0, otherwise make will stop after calling them.

config BR2_ROOTFS_POST_IMAGE_SCRIPT
	string "Custom scripts to run after creating filesystem images"
	default ""
	help
	  Specify a space-separated list of scripts to be run after
	  the build has finished and after Buildroot has packed the
	  files into selected filesystem images.

	  This can for example be used to call a tool building a
	  firmware image from different images generated by Buildroot,
	  or automatically extract the tarball root filesystem image
	  into some location exported by NFS, or any other custom
	  action.

	  These scripts are called with the images directory name as
	  first argument. The script is executed from the main Buildroot
	  source directory as the current directory.

config BR2_ROOTFS_POST_SCRIPT_ARGS
	string "Extra arguments passed to custom scripts"
	depends on BR2_ROOTFS_POST_IMAGE_SCRIPT != "" \
		|| BR2_ROOTFS_POST_IMAGE_SCRIPT != ""
	help
	  Pass these additional arguments to each post-build or
	  post-image scripts.

	  Note that all the post-build and post-image scripts will be
	  passed the same set of arguments, you can not pass different
	  arguments to each script.

	  Note also, as stated in their respective help text, that the
	  first argument to each post-build or post-image script is the
	  target directory / images directory. The arguments in this
	  option will be passed *after* those.

endmenu

source "components/Kconfig"
```

## build/Kconfig.dummy
```kconfig
menu "Dummy configurations"
menu "Dummy configurations in release environment. Do not edit!"
endmenu
endmenu
```

## components/Kconfig
```kconfig
menu "Components"

config CONFIG_PREBUILT_SUBDIR
	string "Prebuilt subdir"
source "prebuilts/Kconfig"

source "applications/Kconfig"
source "newlib/Kconfig"
source "kernel/Kconfig"
source "cmds/Kconfig"
source "pthread/Kconfig"
source "ffmpeg/Kconfig"
source "hc-examples/Kconfig"
source "opencore-amr/Kconfig"
source "libusb/Kconfig"
source "hcfota/Kconfig"
source "liblvgl/Kconfig"
source "bluetooth/Kconfig"
source "quicklz/Kconfig"
source "liblzo/Kconfig"
source "zlib/Kconfig"
source "libopenssl/Kconfig"
source "mbedtls/Kconfig"
source "cjson/Kconfig"
source "hccast/Kconfig"
source "libcurl/Kconfig"
source "unity/Kconfig"
source "memtester/Kconfig"
source "freetype/Kconfig"
source "pcre/Kconfig"

menu "Host utilities"
source "dtc/Config.in.host"
source "uboot-tools/Config.in.host"
source "lzo1x/Config.in.host"
endmenu

source "hclib/Kconfig"

endmenu
```

## components/applications/Kconfig
```kconfig
menu "Applications Configuration"

config CONFIG_APPS_NAME
	string
	default "avp" if BR2_PACKAGE_APPS_AVP
	default "hcboot" if BR2_PACKAGE_APPS_BOOTLOADER
	default "hdmiswitch" if BR2_PACKAGE_APPS_HDMISWITCH
	default "projector" if BR2_PACKAGE_APPS_PROJECTOR
	default "hccast" if BR2_PACKAGE_APPS_HCCAST
	default "hcdemo" if BR2_PACKAGE_APPS_HCDEMO
	default "hccast-sample" if BR2_PACKAGE_APPS_HCCAST_SAMPLECODE
	default "hcscreen" if BR2_PACKAGE_APPS_HCSCREEN
	default "hcscreen-p1" if BR2_PACKAGE_APPS_HCSCREEN_P1
	default "hcscreen-p2" if BR2_PACKAGE_APPS_HCSCREEN_P2
	default "sf2000" if BR2_PACKAGE_APPS_SF2000
	default "spinandwr" if BR2_PACKAGE_APPS_SPINANDWR
	default "b2bupdater" if BR2_PACKAGE_APPS_B2BUPDATER
	default "hcusbcast" if BR2_PACKAGE_APPS_HCUSBCAST
	default "hcrtosapp"
	
config CONFIG_APP_HOSTNAME
	string "hostname"
	default "hichip"

config CONFIG_APP_TIMEZONE
	string "timezone"
	default "GMT-8"

config CONFIG_APP_LOG_LEVEL
	int "log level 0-5"
	default "5"

menu "Application Selection"

comment "Please select only ONE application!"
comment "Select multi-applications will cause un-expected result!"

source "apps-avp/Kconfig"
source "apps-bootloader/Kconfig"
source "apps-hdmiswitch/Kconfig"
source "apps-projector/Kconfig"
source "apps-hccast/Kconfig"
source "apps-hcdemo/Kconfig"
source "apps-hccast-samplecode/Kconfig"
source "apps-hcscreen/Kconfig"
source "apps-hcscreen-p1/Kconfig"
source "apps-hcscreen-p2/Kconfig"
source "apps-sf2000/Kconfig"
source "apps-spinandwr/Kconfig"
source "apps-b2bupdater/Kconfig"
source "apps-kidev/Kconfig"
source "apps-hcusbcast/Kconfig"
source "apps-xbmp5/Kconfig"

endmenu
endmenu
```

## components/applications/apps-avp/Kconfig
```kconfig
menuconfig BR2_PACKAGE_APPS_AVP
	bool "avp"

if BR2_PACKAGE_APPS_AVP
source "source/Kconfig"
endif
```

## components/applications/apps-b2bupdater/Kconfig
```kconfig
menuconfig BR2_PACKAGE_APPS_B2BUPDATER
	bool "b2bupdater"

if BR2_PACKAGE_APPS_B2BUPDATER
source "source/Kconfig"
endif
```

## components/applications/apps-b2bupdater/source/Kconfig
```kconfig
choice
	prompt "Select b2bupdater mode"
	default CONFIG_B2BUPGRADER_UART

	config CONFIG_B2BUPGRADER_UART
		bool "uart"

if  CONFIG_SOC_HC16XX
	config CONFIG_B2BUPGRADER_USB
		bool "usb"
endif

endchoice
```

## components/applications/apps-bootloader/Kconfig
```kconfig
menuconfig BR2_PACKAGE_APPS_BOOTLOADER
	bool "bootloader"

if BR2_PACKAGE_APPS_BOOTLOADER
source "source/Kconfig"
endif
```
