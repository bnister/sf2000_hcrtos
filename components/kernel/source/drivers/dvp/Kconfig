## components/kernel/source/drivers/i2c/Kconfig
```kconfig
# For a description of the syntax of this configuration file,
# see the file kconfig-language.txt in the NuttX tools repository.
#

config CONFIG_ARCH_HAVE_I2CRESET
	bool
	default n

menuconfig CONFIG_I2C
	bool "I2C Driver Support"
	default n
	---help---
		This selection enables building of the "upper-half" I2C driver.
		See include/nuttx/i2c/i2c_master.h for further I2C driver information.

if CONFIG_I2C

config CONFIG_I2C_SCB_MASTER
	bool "I2C SCB Master"
        default y

config CONFIG_I2C_GPIO_MASTER
	bool "I2C GPIO Master"
	default n

menuconfig CONFIG_I2C_SLAVE
	bool "I2C Slave"
	default n

if CONFIG_I2C_SLAVE
config CONFIG_I2C_SLAVE_HDMI
	bool "hdmi I2C Slave"
	default n
endif

config CONFIG_I2C_DRIVER
	bool "I2C character driver"
	default n
	---help---
		Build in support for a character driver at /dev/i2c[N] that may be
		used to perform I2C bus transfers from applications.  The intent of
		this driver is to support I2C testing.  It is not suitable for use
		in any real driver application.
endif
```

## components/kernel/source/drivers/input/Kconfig
```kconfig
menuconfig CONFIG_RC_CORE
	bool "rc core"
	default y

if CONFIG_RC_CORE

source "rc/keymaps/Kconfig"

menuconfig CONFIG_RC_DECODERS
	bool "Remote controller decoders"
	default y

if CONFIG_RC_DECODERS

config CONFIG_IR_NEC_DECODER
	bool "nec decoder"
	default y

endif

menuconfig CONFIG_RC_DEVICES
	bool "Remote Controller devices"
	depends on CONFIG_RC_CORE
	default y

if CONFIG_RC_DEVICES

config CONFIG_RC_HC
	bool "HC remote controls"
	depends on CONFIG_RC_CORE
	default y

endif

endif

menuconfig CONFIG_TP
	bool "tp menu"
	default n

if CONFIG_TP
	source "tp/Kconfig"
endif

menuconfig CONFIG_SAR_ADC
	bool "saradc menu"
	default n

if CONFIG_SAR_ADC
	source "../saradc/Kconfig"
endif

config CONFIG_DRV_GPIO_KEY_GROUP
        bool "gpio key"
        depends on CONFIG_DRV_GPIO
        default n

config  CONFIG_DRV_GPIO_KEY
	bool "hc key gpio driver"
        depends on CONFIG_DRV_GPIO
	default n
```

## components/kernel/source/drivers/input/rc/keymaps/Kconfig
```kconfig
config CONFIG_RC_KEYMAP_HCDEMO
        bool "HC demo remote control receiver"
	depends on CONFIG_RC_CORE
	default y

config CONFIG_RC_KEYMAP_PROJECTOR_C1
	bool "Projector C1 remote control receiver"
	depends on CONFIG_RC_CORE
	default n

config CONFIG_RC_KEYMAP_PROJECTOR_C1_WJV6
	bool "Projector C1 WJV6 remote control receiver"
	depends on CONFIG_RC_CORE
	default n

config CONFIG_RC_KEYMAP_PROJECTOR_C1_AK02
	bool "Projector C1 AK02 remote control receiver"
	depends on CONFIG_RC_CORE
	default n

config CONFIG_RC_KEYMAP_PROJECTOR_C2_D3000
	bool "Projector C2 D3000 remote control receiver"
	depends on CONFIG_RC_CORE
	default n
```

## components/kernel/source/drivers/input/tp/Kconfig
```kconfig
config CONFIG_HC_XPT2046
	bool "xpt2046"
	default n


config CONFIG_HC_HY46XX
	bool "hy46xx"
	default n

config CONFIG_HC_ILITEK
	bool "ilitek"
	default n
```

## components/kernel/source/drivers/lcd/Kconfig
```kconfig
config CONFIG_DRV_LCD_DEV
	bool "lcd dev"
	default n

config CONFIG_DRV_LCD_NT35510
	bool "lcd nt35510 support"
	default n

config CONFIG_DRV_LCD_GC9505
	bool "lcd gc9505 support"
	default n

config CONFIG_DRV_LCD_JDI026
	bool "lcd jdi026 support"
	default n

config CONFIG_DRV_LCD_SC5014A
	bool "lcd sc5014 support"
	default n

config CONFIG_DRV_LCD_JD9168
	bool "lcd jd9168 support"
	default n

config CONFIG_DRV_LCD_ST7789V2
	bool "lcd st7789v2 support"
	default n

config CONFIG_DRV_LCD_N116BGE
	bool "lcd n116bge support"
	default n

config CONFIG_DRV_BACKLIGHT
	bool "backlight support"
	default n
```

## components/kernel/source/drivers/mtd/Kconfig
```kconfig
#
# For a description of the syntax of this configuration file,
# see the file kconfig-language.txt in the NuttX tools repository.
#

menuconfig CONFIG_MTD
	bool "Memory Technology Device (MTD) Support"
	default n
	---help---
		Memory Technology Device (MTD) drivers.  Some simple drivers for
		memory technologies like FLASH, EEPROM, NVRAM, etc.  See
		include/nuttx/mtd/mtd.h

		(Note: This is a simple memory interface and should not be
		confused with the "real" MTD developed at infradead.org.  This
		logic is unrelated; I just used the name MTD because I am not
		aware of any other common way to refer to this class of devices).

if CONFIG_MTD

config CONFIG_MTD_PARTITION
	bool "Support MTD partitions"
	default n
	---help---
		MTD partitions are build as MTD drivers that manage a sub-region
		of the FLASH memory.  The contain the original FLASH MTD driver and
		simply manage all accesses to assure that (1) FLASH accesses are
		always offset to the beginning of the partition, and (2) that FLASH
		accesses do not extend outside of the partition.

		A FLASH device may be broken up into several partitions managed,
		each managed by a separate MTD driver.  The MTD partition interface
		is described in:

			include/nuttx/mtd/mtd.h
			FAR struct mtd_dev_s *mtd_partition(FAR struct mtd_dev_s *mtd, off_t offset, off_t nblocks);

		Each call to mtd_partition() will create a new MTD driver instance
		managing the sub-region of flash beginning at 'offset' (in blocks)
		and of size 'nblocks' on the device specified by 'mtd'.

config CONFIG_FTL_WRITEBUFFER
	bool "Enable write buffering in the FTL layer"
	default n
	depends on DRVR_WRITEBUFFER

config CONFIG_FTL_READAHEAD
	bool "Enable read-ahead buffering in the FTL layer"
	default n
	depends on DRVR_READAHEAD

config CONFIG_MTD_SECT512
	bool "512B sector conversion"
	default n
	---help---
		If enabled, a MTD driver will be created that will convert the
		sector size of any other MTD driver to a 512 byte "apparent" sector
		size.  The managed MTD driver in this case must have an erase block
		size that is greater than 512B and an even multiple of 512B.

if CONFIG_MTD_SECT512

config CONFIG_MTD_SECT512_ERASED_STATE
	hex "Erased state of the FLASH"
	default 0xff

config CONFIG_MTD_SECT512_READONLY
	bool "512B read-only"
	default n

endif # CONFIG_MTD_SECT512

config CONFIG_MTD_PARTITION_NAMES
	bool "Support MTD partition naming"
	depends on CONFIG_MTD_PARTITION
	default n
	---help---
		MTD partitions can be assigned a name for reporting via the procfs
		file system interface.  This adds an API which must be called to
		specify the partition name.

config CONFIG_MTD_BYTE_WRITE
	bool "Byte write"
	default n
	---help---
		Some devices (such as the EON EN25F80) support writing an arbitrary
		number of bytes to FLASH. This setting enables MTD interfaces to
		support such writes.  The SMART file system can take advantage of
		this option if it is enabled.

config CONFIG_MTD_WRBUFFER
	bool "Enable MTD write buffering"
	default n
	depends on CONFIG_DRVR_WRITEBUFFER
	select CONFIG_DRVR_INVALIDATE
	select CONFIG_DRVR_READBYTES
	---help---
		Build the mtd_rwbuffer layer and enable support for write buffering.

if CONFIG_MTD_WRBUFFER

config CONFIG_MTD_NWRBLOCKS
	int "MTD write buffer size"
	default 4
	---help---
		The size of the MTD write buffer (in blocks)

endif # CONFIG_MTD_WRBUFFER

config CONFIG_MTD_READAHEAD
	bool "Enable MTD read-ahead buffering"
	default n
	depends on CONFIG_DRVR_READAHEAD
	select CONFIG_DRVR_INVALIDATE
	select CONFIG_DRVR_READBYTES
	---help---
		Build the mtd_rwbuffer layer and enable support for read-ahead buffering.

if CONFIG_MTD_READAHEAD

config CONFIG_MTD_NRDBLOCKS
	int "MTD read-head buffer size"
	default 4
	---help---
		The size of the MTD read-ahead buffer (in blocks)

endif # CONFIG_MTD_READAHEAD

source "spi-nor/Kconfig"

source "nand/Kconfig"
if CONFIG_MTD_NAND
source "mt29f_spinand/Kconfig"
endif

endif # CONFIG_MTD
```

## components/kernel/source/drivers/mtd/mt29f_spinand/Kconfig
```kconfig
 config CONFIG_MTD_SPINAND_MT29F
	bool "SPINAND Device Support for Micron"
	depends on CONFIG_MTD_NAND && CONFIG_DRV_SPI
	help
	  This enables support for accessing Micron SPI NAND flash
	  devices.
	  If you have Micron SPI NAND chip say yes.

	  If unsure, say no here.

 config CONFIG_MTD_SPINAND_ONDIEECC
	bool "Use SPINAND internal ECC"
	depends on CONFIG_MTD_SPINAND_MT29F
	default n
	help
	  Internal ECC.
	  Enables Hardware ECC support for Micro SPI NAND.

config CONFIG_MTD_SPINAND_TIMEOUT
	int "wait time out(s)"
	range 1 50
	default 40
	depends on CONFIG_MTD_SPINAND_MT29F
	help
	  Set time-out period (s)
```

## components/kernel/source/drivers/mtd/nand/Kconfig
```kconfig
menuconfig CONFIG_MTD_NAND
        bool "NAND device support"
        depends on CONFIG_MTD
        help
	  This enables support for accessing all type of NAND flash
	  devices. For further information see
	  <http://www.linux-mtd.infradead.org/doc/nand.html>.
```

## components/kernel/source/drivers/saradc/Kconfig
```kconfig
config CONFIG_KEY_ADC
	bool "key adc driver"
	default n

config CONFIG_POLL_ADC
	bool "poll adc driver"
	default n

config CONFIG_TOUCH_ADC
	bool "touch adc driver 16xx"
	default n
```

## components/kernel/source/drivers/spi/Kconfig
```kconfig
config CONFIG_SPI_MEM
	bool "SPI memory extension"
	default y
	help
	  Enable this option if you want to enable the SPI memory extension.
	  This extension is meant to simplify interaction with SPI memories
	  by providing a high-level interface to send memory-like commands.

comment "SPI Master Controller Drivers"

config CONFIG_HC_SPI_SF
	bool "HC SPI SF Controller"
	help
	  This is the driver for the SPI Controller.

config CONFIG_HC_SPI_MASTER
	bool "HC SPI Master Controller"
	help
	  This is the driver for the SPI master Controller.

config CONFIG_HC_GPIO_SPI
	bool "HC GPIO SPI Controller"
	help
	  This is the driver for the gpio SPI Controller.

comment "SPI Protocol Masters"
config CONFIG_SPI_SPIDEV
	bool "User mode SPI device driver support"
	help
	  This supports user mode SPI protocol drivers.
```

## components/kernel/source/drivers/virtuart/Kconfig
```kconfig
config CONFIG_VIRTUART_RX_BUF_SIZE
	int "Virtuart rx buffer size"
	default 1024

config CONFIG_VIRTUART_TX_BUF_SIZE
	int "Virtuart tx buffer size"
	default 1024
```

## components/kernel/source/drivers/watchdog/Kconfig
```kconfig
choice
	prompt "watchdog timer running mode"
	default CONFIG_WDT_MODE_WATCHDOG

	config CONFIG_WDT_MODE_WATCHDOG
		bool "watchdog mode"

	config CONFIG_WDT_MODE_TIMER
		bool "timer mode"
endchoice

config CONFIG_WDT_AUTO_FEED
	bool "auto feed watchdog timer in idle task"
	depends on CONFIG_WDT_MODE_WATCHDOG
	default n

config CONFIG_WDT_TIMEOUT 
	int "default timeout (in millisecond) of watchdog timer"
	range 1 120000
	default 20000
```

## components/kernel/source/drivers/wqueue/Kconfig
```kconfig
config CONFIG_SCHED_WORKQUEUE
	bool

config CONFIG_BUILD_FLAT
	bool

config CONFIG_WQUEUE_NOTIFIER
	bool "Generic work notifier"
	default y
	select CONFIG_SCHED_WORKQUEUE
	---help---
		Enable building of work queue notifier logic that will execute a
		worker function an event occurs.  This is is a general purpose
		notifier, but was developed specifically to support poll() logic
		where the poll must wait for an resources to become available.

menuconfig CONFIG_SCHED_RPCWORK
	bool "Enable RPCWORK"
	default y
	select CONFIG_BUILD_FLAT
	select CONFIG_SCHED_WORKQUEUE
	---help---
		rpc workqueue

if CONFIG_SCHED_RPCWORK

config CONFIG_SCHED_RPCNTHREADS
	int "Number of threads for RPCWORK"
	default 8

config CONFIG_SCHED_RPCWORKPRIORITY
	int "Priority for RPCWORK threads"
	default CONFIG_TASK_HIGH_PRIORITY

config CONFIG_SCHED_RPCWORKSTACKSIZE
	hex "Stack size in uint32_t for RPCWORK threads"
	default 0x2000

endif

menuconfig CONFIG_SCHED_HPWORK
	bool "Enable HPWORK"
	default y
	select CONFIG_BUILD_FLAT
	select CONFIG_SCHED_WORKQUEUE
	---help---
		high-priority workqueue

if CONFIG_SCHED_HPWORK

config CONFIG_SCHED_HPNTHREADS
	int "Number of threads for HPWORK"
	default 1

config CONFIG_SCHED_HPWORKPRIORITY
	int "Priority for HPWORK threads"
	default CONFIG_TASK_HIGH_PRIORITY

config CONFIG_SCHED_HPWORKSTACKSIZE
	hex "Stack size in uint32_t for HPWORK threads"
	default 0x2000

endif

menuconfig CONFIG_SCHED_LPWORK
	bool "Enable LPWORK"
	default y
	---help---
		low-priority workqueue

if CONFIG_SCHED_LPWORK

config CONFIG_SCHED_LPNTHREADS
	int "Number of threads for LPWORK"
	default 1

config CONFIG_SCHED_LPWORKPRIORITY
	int "Priority for LPWORK threads"
	default CONFIG_TASK_NORMAL_PRIORITY

config CONFIG_SCHED_LPWORKSTACKSIZE
	hex "Stack size in uint32_t for LPWORK threads"
	default 0x1000

endif
```

## components/kernel/source/dts/Kconfig
```kconfig
menu "Device Tree Control"

config CONFIG_OF_CONTROL
	bool "Run-time configuration via Device Tree"
	select CONFIG_LIB_FDT
	default y
	help
	  This feature provides for run-time configuration via a flattened
	  device tree.

choice           
	prompt "Provider of DTB for DT control"
	depends on CONFIG_OF_CONTROL

config CONFIG_OF_SEPARATE
	bool "Separate DTB for DT control"
	help
	  If this option is enabled, the device tree is passed by bootloader
	  via content in register 0xb8800004.
	  dtbaddr=MIPS_CACHED_ADDR(PHY_ADDR(*(uint32_t*)0xb8800004))

config CONFIG_OF_EMBED
	bool "Embedded DTB for DT control"
	help 
	  If this option is enabled, the device tree will be picked up and
	  built into the kernel. This is suitable for local debugging
	  and development only and is not recommended for production devices.
endchoice

menuconfig CONFIG_CUSTOM_DTS
	bool "Generate custom DTB"

if CONFIG_CUSTOM_DTS
config CONFIG_CUSTOM_DTS_PATH
	string "Device Tree Source file paths"
	help
	  Space-separated list of paths to device tree source files
	  that will be used to generated dtb file.

config CONFIG_DEFAULT_DEVICE_TREE
	string "Default Device Tree"
	help
	  The generated DTB filename that will be installed into
	  $(IMAGES_DIR). The kernel will include it from $(IMAGES_DIR)
	  as embedded data if CONFIG_OF_EMBED is enabled.
endif
endmenu
```

## components/kernel/source/freertos/Kconfig
```kconfig
menu "Task configurations"
config CONFIG_TICK_RATE_HZ
	int "Default OS tick rate in HZ"
	default 1000

config CONFIG_TASK_PERFORMANCE
	bool "Enable Tasks performance staticstics"
	default y

config CONFIG_GENERATE_DETAIL_ISR_RUN_TIME_STATS
	bool "Generate detail ISR run time stats"
	depends on CONFIG_TASK_PERFORMANCE
	default n

config CONFIG_TASK_OPTIMISED_SCHEDULER
	bool "Enable optimized task scheduler"
	default n

config CONFIG_MAX_TASK_NAME_LEN
	int "Max task name length"
	default 16

config CONFIG_TASK_MAX_PRIORITIES
	int "Max task priorities"
	default 32

config CONFIG_TASK_NORMAL_PRIORITY
	int "Task normal priority"
	default 11

config CONFIG_TASK_HIGH_PRIORITY
	int "Task high priority"
	default 14

config CONFIG_TASK_CRITICAL_PRIORITY
	int "Task critical priority"
	default 21

config CONFIG_TIMER_TASK_PRIORITY
	int "Timer task priority"
	default 14

config CONFIG_TIMER_STACK_SIZE
	hex "Timer task stack size in uint32_t"
	default 0x400

config CONFIG_TIMER_QUEUE_LENGTH
	int "Timer queue length in bytes"
	default 1024

config CONFIG_TASK_STACK_SIZE
	hex "Default task stack size in uint32_t"
	default 0x1000

config CONFIG_MINIMAL_TASK_STACK_SIZE
	hex "Default minimal task stack size in uint32_t"
	default 0x100

config CONFIG_ISR_STACK_SIZE
	hex "ISR stack size in uint32_t"
	default 0x400

config CONFIG_TASK_NOTIFICATION_ARRAY_ENTRIES
	int "Task notification array entries"
	default 5
endmenu
```

## components/kernel/source/fs/Kconfig
```kconfig
menu "File system configuration"

menuconfig CONFIG_VFS
	bool "Enable VFS"
	default y

if CONFIG_VFS
source "vfs/Kconfig"
endif

menuconfig CONFIG_MMAP
	bool "Enable mmap"
	default y

if CONFIG_MMAP
source "mmap/Kconfig"
endif

source "elmfat/Kconfig"
source "romfs/Kconfig"
source "littlefs/Kconfig"
source "yaffs2/Kconfig"

menuconfig CONFIG_PARTITION
	bool "Enable partition"
	default n

if CONFIG_PARTITION
source "partition/Kconfig"
endif

source "mount/Kconfig"

endmenu
```
