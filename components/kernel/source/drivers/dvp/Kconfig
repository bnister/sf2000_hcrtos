## components/kernel/source/fs/elmfat/Kconfig
```kconfig
config CONFIG_FS_ELMFAT
	bool "FF FAT file system"
	default n
	depends on !CONFIG_DISABLE_MOUNTPOINT
	---help---
		Enable FAT filesystem support

config CONFIG_FSUTILS_FF_MKFATFS
	bool "mkfatfs utility"
	default y
	depends on CONFIG_FS_ELMFAT && !CONFIG_DISABLE_PSEUDOFS_OPERATIONS
	---help---
		Enables support for the mkfatfs utility
```

## components/kernel/source/fs/mount/Kconfig
```kconfig
config CONFIG_FS_AUTOMOUNTER
	bool "Auto-mounter"
	default n
	select CONFIG_SCHED_LPWORK
	---help---
	  The automounter provides an OS-internal mechanism for automatically
	  mounting and unmounting removable media as the media is inserted and
	  removed.
```
