## components/kernel/source/fs/partition/Kconfig
```kconfig
# For a description of the syntax of this configuration file,
# see the file kconfig-language.txt in the NuttX tools repository.
#

menu "Partition Table"

config CONFIG_PTABLE_PARTITION
	bool "PTABLE support"
	default n

config CONFIG_MBR_PARTITION
	bool "MBR support"
	default n

config CONFIG_GPT_PARTITION
	bool "GPT support"
	default n

endmenu
```

## components/kernel/source/fs/vfs/Kconfig
```kconfig
config CONFIG_PATH_MAX
	int "Maximum size of path name"
	default 512
	---help---
		The maximum size of path name.

config CONFIG_NAME_MAX
	int "Maximum size of a file name"
	default 64
	---help---
		The maximum size of a file name.
config CONFIG_FILE_MODE
	bool "Enable file mode"
	default n

config CONFIG_DISABLE_MOUNTPOINT
	bool "Disable support for mount points"
	default n

config CONFIG_DISABLE_PSEUDOFS_OPERATIONS
	bool "Disable pseudo-filesystem operations"
	default n
	---help---
		Disable certain operations on pseudo-file systems include mkdir,
		rmdir, unlink, and rename.  These are necessary for the logical
		completeness of the illusion created by the pseudo-filesystem.
		However, in practical embedded system, they are seldom needed and
		you can save a little FLASH space by disabling the capability.

config CONFIG_NFILE_DESCRIPTORS_PER_BLOCK
	int "The number of file descriptors per block"
	default 8
	range 3 99999
	---help---
		The number of file descriptors per block(one for each open)

config CONFIG_INLINE_POLL_NFILE_DESCRIPTORS
	int "Inline poll file descriptors"
	default 5
	---help---
		The inline poll file descriptors in one call
		to avoid frequently malloc/free. If polling more file
		descriptors in one call, dynamic malloc/free is used.

config CONFIG_NAME_MAX
	int "Maximum size of a file name"
	default 32
	---help---
		The maximum size of a file name.

config CONFIG_PATH_MAX
	int "Maximum size of path name"
	default 256
	---help---
		The maximum size of path name.

config CONFIG_LIB_SENDFILE_BUFSIZE
	int "sendfile() buffer size"
	default 512
	---help---
		Size of the I/O buffer to allocate in sendfile().  Default: 512b

config CONFIG_DISABLE_MQUEUE
	bool "Disable POSIX message queue support"
	default y
```

## components/kernel/source/fs/yaffs2/Kconfig
```kconfig
config CONFIG_FS_YAFFS2
	bool "yaffs2 file system"
	default n
	depends on !CONFIG_DISABLE_MOUNTPOINT
	---help---
		Enable Yaffs2 filesystem support
```

## components/kernel/source/lib/Kconfig
```kconfig
menu "Libraries"

config CONFIG_LIB_FDT
	bool "Enable the FDT library (RO)"
	default y

config CONFIG_LIB_CONSOLE
	bool "Console commandline support"
	default y

menuconfig CONFIG_LIB_ELOG
	bool "Easylogger support"
	default y

if CONFIG_LIB_ELOG
source "easylogger/Kconfig"
endif

config CONFIG_LIB_CRC
	bool "CRC support"
	default n

config CONFIG_LIB_LZMA
	bool "LZMA decompress support"
	default n

config CONFIG_LIB_GZIP
	bool "GZIP decompress support"
	select BR2_PACKAGE_ZLIB
	default n

config CONFIG_LIB_RSA
	bool "RSA support"
	default n

source "libc/Kconfig"

endmenu
```

## components/kernel/source/lib/easylogger/Kconfig
```kconfig
choice 
	prompt "Work mode"
	default CONFIG_EASYLOGGER_NORMAL

	config CONFIG_EASYLOGGER_NORMAL
		bool "Normal"
	config CONFIG_EASYLOGGER_PRINTF
		bool "Printf"
	config CONFIG_EASYLOGGER_DISABLE
		bool "Disable"
endchoice
choice
	prompt "Line end"
	default CONFIG_EASYLOGGER_LINE_END_LF

	config CONFIG_EASYLOGGER_LINE_END_LF
		bool "Unix: LF"
	config CONFIG_EASYLOGGER_LINE_END_CRLF
		bool "Dos: CRLF"
	config CONFIG_EASYLOGGER_LINE_END_NONE
		bool "None"
endchoice
config CONFIG_EASYLOGGER_COLOR_ENABLE
	bool "Color enable"
	default y

config CONFIG_EASYLOGGER_LINE_BUF_SIZE
	int "Buffer size for every line's log"
	default 1024
```

## components/kernel/source/lib/libc/Kconfig
```kconfig
menu "Memory Management"

config CONFIG_MEM_NR_MMZ
	int "Multi media memory zone number"
	default 1

config CONFIG_MEM_DEBUG_STORE
	bool "Memory store check"
	default n
	help
	  Check memory overflow in memset/memcpy/memmove/strcat/strcpy/strncat/strncpy

menuconfig CONFIG_MEM_DEBUG_MONITOR
	bool "Memory monitor (integrity/leak/caller/task)"
	default n

if CONFIG_MEM_DEBUG_MONITOR

config CONFIG_MEM_DEBUG_LR_CNT
	int "Max link register to record"
	default 5

config CONFIG_MEM_DEBUG_LR_OMIT_CNT
	int "The omit layers of function call"
	default 2

config CONFIG_MEM_DEBUG_RECORD_TASKID
	bool "Record taskid"
	default 5

endif

endmenu
```

## components/kernel/source/net/Kconfig
```kconfig
menu "Net"
menuconfig CONFIG_NET
	bool "Enable network"
	default n

if CONFIG_NET
config CONFIG_NET_LWIP_SACK
	bool "Enable Lwipsack"
	default y

	help
	  Answer Y to enable LiteOS support lwip.

choice
	depends on CONFIG_NET_LWIP_SACK
	prompt "Lwipsack"
	default CONFIG_NET_LWIP_SACK_2_1_2
	help
	  Enable Lwipsack for 2.x

config CONFIG_NET_LWIP_SACK_2_1_2
	bool "Enable Lwipsack (2.1.2)"
	depends on CONFIG_NET_LWIP_SACK

config CONFIG_NET_LWIP_SACK_2_1_3
	bool "Enable Lwipsack (2.1.3)"
	depends on CONFIG_NET_LWIP_SACK

endchoice

config CONFIG_NET_LWIP_PPP
	bool "ppp support"
	default n

config CONFIG_NET_LWIP_IPV6
	bool "ipv6 support"
	default n

config CONFIG_NET_LWIP_BRIDGE
	bool "bridge support"
	default n

config CONFIG_NET_LWIP_SLIP
	bool "SLIP protocol support"
	default n

config CONFIG_NET_LWIP_6LOWPAN
	bool "6LoWPAN support"
	default n

config CONFIG_NET_LWIP_DIS_UDP_CHECKSUM_CHECK
	bool "Disable udp checksum check"
	default n

config CONFIG_NET_LWIP_DIS_TCP_CHECKSUM_CHECK
	bool "Disable tcp checksum check"
	default n

config CONFIG_NET_LWIP_DIS_IP_CHECKSUM_GEN
	bool "Disable ip checksum check"
	default n

config CONFIG_NETDEV_BUDGET
	int "Net device budget"
	default 300
	help
		Net device buget is for net device receive softirq,
		which every time irq receive max packats nums

endif
endmenu
```

## components/kernel/source/sound/Kconfig
```kconfig
menuconfig CONFIG_SOUND
	bool "Sound core"
	default y

if CONFIG_SOUND

choice
	prompt "audsink force bitdepth out"
	default CONFIG_AUDSINK_16BIT_OUT

config CONFIG_AUDSINK_16BIT_OUT
	bool "16bit out"

config CONFIG_AUDSINK_24BIT_OUT
	bool "24bit out"

endchoice

endif
```

## components/kernel/source/third_party/nuttx/drivers/bch/Kconfig
```kconfig
#
# For a description of the syntax of this configuration file,
# see the file kconfig-language.txt in the NuttX tools repository.
#

menuconfig CONFIG_DRV_BCH
	bool "Block-to-Character (BCH) Support"
	default n
	---help---
		Contains logic that may be used to convert a block driver into
		a character driver.  This is the complementary conversion as that
		performed by loop.c.  See include/nuttx/drivers/drivers.h for
		registration information.

if CONFIG_DRV_BCH

config CONFIG_BCH_ENCRYPTION
	bool "Enable BCH encryption"
	default n

config CONFIG_BCH_ENCRYPTION_KEY_SIZE
	int "AES key size"
	default 16
	depends on CONFIG_BCH_ENCRYPTION

endif # BCH
```

## components/kernel/source/third_party/nuttx/drivers/crypto/Kconfig
```kconfig
# For a description of the syntax of this configuration file,
# see the file kconfig-language.txt in the NuttX tools repository.
#
menuconfig CONFIG_DEV_URANDOM
	bool "Enable /dev/urandom"
	default n
	---help---
		Enable support for /dev/urandom provided by either a hardware TRNG or
		by a software PRNG implementation.

		NOTE:  This option may not be cryptographially secure and should not
		be enabled if you are concerned about cyptographically secure
		pseudo-random numbers (CPRNG) and do not know the characteristics
		of the software PRNG implementation!

if CONFIG_DEV_URANDOM

choice
	prompt "/dev/urandom algorithm"
	default CONFIG_DEV_URANDOM_CONGRUENTIAL

config CONFIG_DEV_URANDOM_CONGRUENTIAL
	bool "Congruential"
	---help---
		Use the same congruential general used with srand().  This algorithm
		is computationally more intense and uses double precision floating
		point.  NOTE: Good randomness from the congruential generator also
		requires that you also select CONFIG_LIBC_RAND_ORDER > 2

		NOTE: Not cyptographically secure
endchoice # /dev/urandom algorithm
endif # DEV_URANDOM
```

## components/kernel/source/third_party/nuttx/drivers/pipes/Kconfig
```kconfig
#
# For a description of the syntax of this configuration file,
# see the file kconfig-language.txt in the NuttX tools repository.
#

menuconfig CONFIG_PIPES
	bool "FIFO and named pipe drivers"
	default n
	---help---
		FIFO and named pipe drivers.  Standard interfaces are declared
		in include/unistd.h

if CONFIG_PIPES

config CONFIG_DEV_PIPE_MAXSIZE
	int "Maximum pipe/FIFO size"
	default 65535
	---help---
		Maximum configurable size of a pipe or FIFO at runtime.

config CONFIG_DEV_PIPE_SIZE
	int "Default pipe size"
	default 256
	---help---
		Sets the default size of the pipe ringbuffer in bytes.  A value of
		zero disables pipe support.

config CONFIG_DEV_FIFO_SIZE
	int "Default FIFO size"
	default 256
	---help---
		Sets the default size of the FIFO ringbuffer in bytes.  A value of
		zero disables FIFO support.

config CONFIG_DEV_PIPE_VFS_PATH
	string "Path to the pipe device"
	default "/dev/pipe"
	---help---
		The path to where pipe device will exist in the VFS namespace.

config CONFIG_DEV_PIPEDUMP
	bool "Enable dump pipe data"
	default n

endif # PIPES
```

## components/kernel/source/third_party/nuttx/fs/littlefs/Kconfig
```kconfig
config CONFIG_FS_LITTLEFS
	bool "LITTLEFS File System"
	default n
	depends on !DISABLE_MOUNTPOINT
	---help---
		Build the LITTLEFS file system. https://github.com/littlefs-project/littlefs.

if CONFIG_FS_LITTLEFS
config CONFIG_FS_LITTLEFS_BLOCK_FACTOR
	int "LITTLEFS Block size multiple factor"
	default 1
	---help---
		Configure the cache size of the LITTLEFS file system with a multiple factor of the block size.
	
config CONFIG_FS_LITTLEFS_BLOCK_CYCLE
	int "LITTLEFS Block Cycle"
	default 200
	---help---
		Configure the block cycle of the LITTLEFS file system.
endif
```

## components/kernel/source/third_party/nuttx/fs/mkfatfs/Kconfig
```kconfig
#
# For a description of the syntax of this configuration file,
# see the file kconfig-language.txt in the NuttX tools repository.
#

config CONFIG_FSUTILS_MKFATFS
	bool "mkfatfs utility"
	default y
	depends on CONFIG_FS_FAT && !CONFIG_DISABLE_PSEUDOFS_OPERATIONS
	---help---
		Enables support for the mkfatfs utility
```

## components/kernel/source/third_party/nuttx/fs/romfs/Kconfig
```kconfig
#
# For a description of the syntax of this configuration file,
# see the file kconfig-language.txt in the NuttX tools repository.
#

config CONFIG_FS_ROMFS
	bool "ROMFS file system"
	default n
	depends on !CONFIG_DISABLE_MOUNTPOINT
	---help---
		Enable ROMFS filesystem support

if CONFIG_FS_ROMFS
endif
```

## components/liblvgl/Kconfig
```kconfig
menuconfig BR2_PACKAGE_LIBLVGL
	bool "liblvgl"
	default n
	help
	  LVGL library and test bench

if BR2_PACKAGE_LIBLVGL
#source "source/Kconfig"
endif
if BR2_PACKAGE_LIBLVGL


config BR2_PACKAGE_LIBLVGL_CONFIG
	string "liblvgl configuration file"
	default "$(TOPDIR)/components/liblvgl/liblvgl.config"
	help
	  Path to the liblvgl configuration file.

	  I you wish to use your own modified liblvgl configuration
	  file specify the config file location with this option.

#config BR2_LIBLVGL_ENABLE_DEMO
	#bool "liblvgl demo app"
	#default n

#choice
	#prompt "select lvgl demo case"
	#depends on BR2_LIBLVGL_ENABLE_DEMO
	#default BR2_LIBLVGL_DEMO_WIDGETS
	#help
	  #Select Hichip screen application

#config BR2_LIBLVGL_DEMO_STRESS
	#bool "demo stress"
	#default n
#config BR2_LIBLVGL_DEMO_MUSIC
	#bool "demo music"
	#default n
#config BR2_LIBLVGL_DEMO_BENCHMARK
	#bool "demo benchmark"
	#default n
#config BR2_LIBLVGL_DEMO_WIDGETS
	#bool "demo widgets"
	#default n
#endchoice
endif
```

## components/liblvgl/source/Kconfig
```kconfig
source "lvgl/Kconfig"

config  LV_USE_GPU_HICHIP
    bool "Enable hichip gpu"
    default y

config LV_HC_SCREEN_HOR_RES 
	int "lvgl horizon resolution"
	default 1280

config LV_HC_SCREEN_VER_RES 
	int "lvgl horizon resolution"
	default 720

config LV_HC_DRAW_BUF_SIZE
	int "lvgl draw buffer size"
	default 0
	help 
	lvgl draw buffer size, in pixel, sugest at least 10 * LV_HC_SCREEN_HOR_RES
	default zero, then it is equal to LV_HC_SCREEN_HOR_RES * LV_HC_SCREEN_VER_RES)

config LV_HC_DRAW_BUF_COUNT
	int "draw buffer count"
	default 1
	range 1 2

config LV_USE_DUAL_FRAMEBUFFER 
	bool "Enable dual framebuffer"
	default y

config LVGL_DEMO_APP
	bool "Enable demo app"
	default n

choice LV_HC_FB_COLOR_DEPTH
    prompt "Framebuffer color depth."
    default LV_HC_FB_COLOR_DEPTH_16_ARGB4444
    help
	Framebuffer color depth to be used.

    config LV_HC_FB_COLOR_DEPTH_32
	bool "32: ARGB8888"
    config LV_HC_FB_COLOR_DEPTH_16_ARGB1555
	bool "16: ARGB1555"
    config LV_HC_FB_COLOR_DEPTH_16_ARGB4444
	bool "16: ARGB4444"
endchoice

config LV_HC_FB_COLOR_DEPTH
    int
    default 16 if LV_HC_FB_COLOR_DEPTH_16_ARGB4444 || LV_HC_FB_COLOR_DEPTH_16_ARGB1555
    default 32 if LV_HC_FB_COLOR_DEPTH_32

menu "Hichip create font"
	config SIYUANHEITI_LIGHT_18_1B
                bool "Enable Chinse SiYuanHeiTi-Lightx 18, Bpp 1b" 
		default n
	config SIYUANHEITI_LIGHT_22_1B
                bool "Enable Chinse SiYuanHeiTi-Lightx 22, Bpp 1b" 
		default n
	config SIYUANHEITI_LIGHT_28_1B
                bool "Enable Chinse SiYuanHeiTi-Lightx 28, Bpp 1b" 
		default n
	config SIYUANHEITI_LIGHT_28_2B
                bool "Enable Chinse SiYuanHeiTi-Lightx 28, Bpp 2b" 
		default n
	config SIYUANHEITI_LIGHT_28_4B
                bool "Enable Chinse SiYuanHeiTi-Lightx 28, Bpp 4b" 
		default n
	config SIYUANHEITI_LIGHT_3000_28_1B
                bool "Enable Chinse SiYuanHeiTi-Lightx_3000 28, Bpp 1b" 
		default n
endmenu

config LVGL_HC_IR
	bool "Enable IR"
	default n
	
config LV_HC_KEYSTONE_AA_SW_FIX
	bool "Enable keystone AA by using fb"
	default n
```

## components/liblzo/Kconfig
```kconfig
config BR2_PACKAGE_LIBLZO
	bool "liblzo"
	default n
	help
	  Lzo decompress algo with USE_LZO1X only
```

## components/libopenssl/Kconfig
```kconfig
menuconfig BR2_PACKAGE_LIBOPENSSL
	bool "libopenssl"
	depends on CONFIG_NET

if BR2_PACKAGE_LIBOPENSSL
config BR2_PACKAGE_LIBOPENSSL_DH_SUPPORT
	bool "dh support"
	default n
endif
```

## components/libusb/Kconfig
```kconfig
config BR2_PACKAGE_LIBUSB
	bool "libusb"
	select BR2_PACKAGE_PREBUILTS_USBDRIVE
	select CONFIG_PIPES
	default n
	help
		userspace library for accessing USB devices 

config BR2_PACKAGE_LIBUSB_EXAMPLES
	bool "build libusb examples"
	depends on BR2_PACKAGE_LIBUSB
	select CONFIG_CMDS_LIBUSB_EXAMPLES
```

## components/lzo1x/Config.in.host
```kconfig
config BR2_PACKAGE_HOST_LZO1X
	bool "lzo1x"
	default n
	help
	  Portable lossless data compression library written in ANSI C.

	  http://www.oberhumer.com/opensource/lzo/
```

## components/memtester/Kconfig
```kconfig
config BR2_PACKAGE_MEMTESTER
	bool "memtester"
	default n
	help
	  A utility for testing the memory subsystem for
	  faults.

	  http://pyropus.ca/software/memtester/
```

## components/newlib/Kconfig
```kconfig
menuconfig BR2_PACKAGE_NEWLIB
	bool "Newlib"
	default y

if BR2_PACKAGE_NEWLIB
config CONFIG_NEWLIB_USE_PREBUILT
	bool "Use prebuilt newlib"
	default y
endif
```
