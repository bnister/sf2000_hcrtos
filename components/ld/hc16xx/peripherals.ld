PROVIDE ( IRC0            = 0xb8818100 );
PROVIDE ( UART0           = 0xb8818300 );
PROVIDE ( UART1           = 0xb8818600 );
PROVIDE ( UART2           = 0xb8818800 );
PROVIDE ( UART3           = 0xb8818900 );
PROVIDE ( SFSPI0          = 0xb882e000 );
PROVIDE ( SPIMASTER       = 0xb8848000 );
PROVIDE ( MMBOX0          = 0xb8800800 );
PROVIDE ( MMBOX1          = 0xb8800820 );
PROVIDE ( MMBOX2          = 0xb8800840 );
PROVIDE ( MMBOX3          = 0xb8800860 );
PROVIDE ( MMBOX4          = 0xb8800880 );
PROVIDE ( MMBOX5          = 0xb88008a0 );
PROVIDE ( MMBOX6          = 0xb88008c0 );
PROVIDE ( MMBOX7          = 0xb88008e0 );
PROVIDE ( SMBOX0          = 0xb8866800 );
PROVIDE ( SMBOX1          = 0xb8866820 );
PROVIDE ( SMBOX2          = 0xb8866840 );
PROVIDE ( SMBOX3          = 0xb8866860 );
PROVIDE ( SMBOX4          = 0xb8866880 );
PROVIDE ( SMBOX5          = 0xb88668a0 );
PROVIDE ( SMBOX6          = 0xb88668c0 );
PROVIDE ( SMBOX7          = 0xb88668e0 );
PROVIDE ( TIMER00         = 0xb8818a00 );
PROVIDE ( TIMER10         = 0xb8818a10 );
PROVIDE ( TIMER20         = 0xb8818a20 );
PROVIDE ( TIMER30         = 0xb8818a30 );
PROVIDE ( TIMER40         = 0xb8818a40 );
PROVIDE ( TIMER50         = 0xb8818a50 );
PROVIDE ( TIMER60         = 0xb8818a60 );
PROVIDE ( TIMER70         = 0xb8818a70 );
PROVIDE ( HWSPINLOCK      = 0xb8867000 );
PROVIDE ( SND0            = 0xb880a000 );
PROVIDE ( SND0_DAC        = 0xb880b000 );
PROVIDE ( SYSIO0          = DEFINED(__mips32r1__) ? 0xb8866000 : 0xb8800000 );
PROVIDE ( MSYSIO0         = 0xb8800000 );
PROVIDE ( PINMUXL         = 0xb88004a0 );
PROVIDE ( PINMUXB         = 0xb88004e0 );
PROVIDE ( PINMUXR         = 0xb8800520 );
PROVIDE ( PINMUXT         = 0xb8800560 );
PROVIDE ( GPIOLCTRL       = 0xb8800044 );
PROVIDE ( GPIOBCTRL       = 0xb88000c4 );
PROVIDE ( GPIORCTRL       = 0xb88000e4 );
PROVIDE ( GPIOTCTRL       = 0xb8800344 );
PROVIDE ( I2C0CTRL        = 0xb8818200 );
PROVIDE ( I2C1CTRL        = 0xb8818700 );
PROVIDE ( I2C2CTRL        = 0xb8818b00 );
PROVIDE ( I2C3CTRL        = 0xb8818c00 );
PROVIDE ( PWMCTRL         = 0xb8818410 );
PROVIDE ( WDT0            = 0xb8818500 );
PROVIDE ( ADCCTRL         = 0xb8818400 );
PROVIDE ( POKCTRL         = 0xb8800450 );
PROVIDE ( USB0            = 0xb8844000 );
PROVIDE ( USB1            = 0xb8850000 );

PROVIDE ( GPIO_INTR             = (8 + (32*0) + 0));
PROVIDE ( H264_INTR             = (8 + (32*0) + 1));
PROVIDE ( DE_INTR               = (8 + (32*0) + 2));
PROVIDE ( IHB_VIN_INTR          = (8 + (32*0) + 3));
PROVIDE ( GE_INTR               = (8 + (32*0) + 4));
PROVIDE ( SND_INTR              = (8 + (32*0) + 5));
PROVIDE ( TSG_INTR              = (8 + (32*0) + 6));
PROVIDE ( DEMUX0_INTR           = (8 + (32*0) + 7));
PROVIDE ( DEMUX1_INTR           = (8 + (32*0) + 8));
PROVIDE ( TSI_INTR              = (8 + (32*0) + 9));
PROVIDE ( SD_MMC_INTR           = (8 + (32*0) + 10));
PROVIDE ( DMA1_INTR             = (8 + (32*0) + 11));
PROVIDE ( DMA0_INTR             = (8 + (32*0) + 12));
PROVIDE ( HDMI_INTR             = (8 + (32*0) + 13));
PROVIDE ( MAC_INTR              = (8 + (32*0) + 14));
PROVIDE ( MAC_WOL_INTR          = (8 + (32*0) + 15));
PROVIDE ( UART0_INTR            = (8 + (32*0) + 16));
PROVIDE ( UART1_INTR            = (8 + (32*0) + 17));
PROVIDE ( I2C0_INTR             = (8 + (32*0) + 18));
PROVIDE ( IRC_INTR              = (8 + (32*0) + 19));
PROVIDE ( RTC_INTR              = (8 + (32*0) + 22));
PROVIDE ( WTD_INTR              = (8 + (32*0) + 23));
PROVIDE ( SD_MMC_DMA_INTR       = (8 + (32*0) + 24));
PROVIDE ( I2C1_INTR             = (8 + (32*0) + 25));
PROVIDE ( I2C2_INTR             = (8 + (32*0) + 26));
PROVIDE ( DRAM_INTR             = (8 + (32*0) + 27));
PROVIDE ( I2SI_PCM_PDM_TDM_INTR = (8 + (32*0) + 29));
PROVIDE ( MCPU_ILB_ACK_INTR     = (8 + (32*0) + 30));
PROVIDE ( MCPU_BUS_ERR_INTR     = (8 + (32*0) + 31));

PROVIDE ( VIN_TBD_INTR          = (8 + (32*1) + 1));
PROVIDE ( SPI_MASTER_INTR       = (8 + (32*1) + 2));
PROVIDE ( SF_INTR               = (8 + (32*1) + 3));
PROVIDE ( HDMI_PHY_INTR         = (8 + (32*1) + 4));
PROVIDE ( SAR_ADC_INTR          = (8 + (32*1) + 5));
PROVIDE ( TSDMA_INTR            = (8 + (32*1) + 6));
PROVIDE ( JPEG_ENCODER_INTR     = (8 + (32*1) + 7));
PROVIDE ( DE4K_INTR             = (8 + (32*1) + 8));
PROVIDE ( DE4K_EXTI_INTR        = (8 + (32*1) + 9));
PROVIDE ( MIPI_INTR             = (8 + (32*1) + 10));
PROVIDE ( I2C3_INTR             = (8 + (32*1) + 11));
PROVIDE ( DESCRAMBLER_INTR      = (8 + (32*1) + 12));
PROVIDE ( HRX_INTR              = (8 + (32*1) + 13));
PROVIDE ( SEMAPHORE_N1_INTR     = (8 + (32*1) + 14));
PROVIDE ( VID_CVBS_INTR         = (8 + (32*1) + 15));
PROVIDE ( NF_INTR               = (8 + (32*1) + 16));
PROVIDE ( USB1_DMA_INTR         = (8 + (32*1) + 18));
PROVIDE ( USB1_MC_INTR          = (8 + (32*1) + 19));
PROVIDE ( USB0_DMA_INTR         = (8 + (32*1) + 20));
PROVIDE ( USB0_MC_INTR          = (8 + (32*1) + 21));
PROVIDE ( UART2_INTR            = (8 + (32*1) + 22));
PROVIDE ( UART3_INTR            = (8 + (32*1) + 23));
PROVIDE ( VID_HDMI_INTR         = (8 + (32*1) + 24));
PROVIDE ( VE_INTR               = (8 + (32*1) + 25));
PROVIDE ( POK_OUT_INTR          = (8 + (32*1) + 26));
PROVIDE ( SEMAPHORE_N0_INTR     = (8 + (32*1) + 27));
PROVIDE ( HRX_HOT_PLUG_INTR     = (8 + (32*1) + 28));
PROVIDE ( SCPU_ILB_ACK_INTR     = (8 + (32*1) + 30));
PROVIDE ( SCPU_BUS_ERR_INTR     = (8 + (32*1) + 31));
PROVIDE ( CPU_ILB_ACK_INTR      = DEFINED(__mips32r1__) ? (8 + (32*1) + 30): (8 + (32*0) + 30));
PROVIDE ( CPU_BUS_ERR_INTR      = DEFINED(__mips32r1__) ? (8 + (32*1) + 31): (8 + (32*0) + 31));

PROVIDE ( MBOX_INTR             = (8 + (32*2) + 2));
