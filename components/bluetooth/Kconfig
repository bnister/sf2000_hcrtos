## components/hccast/Kconfig
```kconfig
menuconfig BR2_PACKAGE_HCCAST
	bool "hccast"
	default n
	help
	  Hichip screen casting middleware and simple demo application

if BR2_PACKAGE_HCCAST

config BR2_PACKAGE_HCCAST_NET
	bool "Wi-Fi MGR & DHCP"
	default n
	help
	  Support Wi-Fi Manager and DHCP server/client API

config BR2_PACKAGE_HCCAST_WIRELESS
	bool "Wireless casting"
	default n
	select BR2_PACKAGE_HCCAST_NET
	help
	  Support Wireless casting API, DLNA/Miracast/Aircast
	  
if BR2_PACKAGE_HCCAST_WIRELESS

config BR2_PACKAGE_HCCAST_AIRCAST
	bool "Aircast"
	default y
	select CONFIG_SPI_SPIDEV
	select CONFIG_DRV_SPI

if BR2_PACKAGE_HCCAST_AIRCAST

config BR2_PACKAGE_HCCAST_AIRCAST_MIRROR_ONLY
	bool "Air-mirror only"
	default n
	help
	  Support Aircast only support screen mirrorring mode

endif

config BR2_PACKAGE_HCCAST_MIRACAST
	bool "Miracast"
	default y

config BR2_PACKAGE_HCCAST_DLNA
	bool "DLNA"
	default y

endif

config BR2_PACKAGE_HCCAST_USBMIRROR
	bool "USB mirrorring"
	default n
	select CONFIG_DRV_SPI
	select CONFIG_SPI_SPIDEV
	help
	  Support IUM & AUM

config BR2_PACKAGE_HCCAST_IPTV
	bool "IPTV porting layer"
	default n
	help
	  Support IPTV API

endif
```

## components/hcfota/Kconfig
```kconfig
config BR2_PACKAGE_HCFOTA
	bool "hcfota"
	select BR2_PACKAGE_PREBUILTS_USBDRIVE
	default n
	help
	  Hichip Firmware Over The Aire
```

## components/hclib/Kconfig
```kconfig
menu "Hichip Libs"
source "viddriver/Kconfig"
source "auddriver/Kconfig"
source "libacodec/Kconfig"
source "mipidriver/Kconfig"
source "ffplayer/Kconfig"
source "lnxporting/Kconfig"
source "usbdriver/Kconfig"
source "mmcdriver/Kconfig"
source "libntfs/Kconfig"
source "libtoe/Kconfig"
source "libdsc/Kconfig"
source "libge/Kconfig"
source "ddrinit/Kconfig"
source "libws2811/Kconfig"
source "display/Kconfig"
source "libefuse/Kconfig"
source "rtl8188fu/Kconfig"
source "rtl8188eu/Kconfig"
source "rtl8811cu/Kconfig"
source "rtl8733bu/Kconfig"
source "wpa_supplicant/Config.in"
source "wireless_tools/Config.in"
endmenu
```

## components/hclib/auddriver/Kconfig
```kconfig
menuconfig BR2_PACKAGE_AUDDRIVER
	bool "audio driver"
	default n

if BR2_PACKAGE_AUDDRIVER

config CONFIG_AUDDRIVER_DEBUG
	bool "Enable debug"
	default n

endif
```

## components/hclib/display/Kconfig
```kconfig
menu "Display library"

source "libusbmirror/Kconfig"
source "libaircast/Kconfig"
source "libdlna/Kconfig"
source "libmiracast/Kconfig"
source "libyoutube/Kconfig"

endmenu
```

## components/hclib/display/libyoutube/Kconfig
```kconfig
config BR2_PACKAGE_DISP_IPTV_YT
	bool "IPTV YT service Lib"
	default n
	select BR2_PACKAGE_PCRE
	select BR2_PACKAGE_CJSON
	select BR2_PACKAGE_LIBCURL
	select BR2_PACKAGE_HCCAST_IPTV
	help
	  Support IPTV YT Service API
```

## components/hclib/ffplayer/Kconfig
```kconfig
config BR2_PACKAGE_FFPLAYER
	bool "ffplayer"
	select BR2_PACKAGE_FFMPEG
	select BR2_PACKAGE_PTHREAD
	default n
```

## components/hclib/libacodec/Kconfig
```kconfig
menuconfig BR2_PACKAGE_LIBACODEC
	bool "lib audio codec"
	default n

if BR2_PACKAGE_LIBACODEC

config CONFIG_LIBACODEC_DEBUG
	bool "Enable debug"
	default n

endif
```

## components/hclib/libdsc/Kconfig
```kconfig
menuconfig BR2_PACKAGE_LIBDSC
	bool "dsc library"

if BR2_PACKAGE_LIBDSC

config CONFIG_LIBDSC_DEBUG
	bool "Enable debug"
	default n
endif
```
