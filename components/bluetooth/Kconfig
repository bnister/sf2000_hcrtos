## components/bluetooth/Kconfig
```kconfig
menuconfig BR2_PACKAGE_BLUETOOTH
    bool "bluetooth"
    default n
if BR2_PACKAGE_BLUETOOTH
choice
    prompt "bluetooth select"
    default BR2_PACKAGE_AD6956F
    source "ad6956f/Kconfig"
    source "ac6955f/Kconfig"
endchoice
choice
    prompt "facticity"
	default BR2_PACKAGE_BLUETOOTH_FAKE
	config BR2_PACKAGE_BLUETOOTH_TURE
	bool "ture"
	help
		Bluetooth ad6956f module api

	config BR2_PACKAGE_BLUETOOTH_FAKE
	bool "fake"
	help
		Bluetooth ad6956f module api
endchoice
endif
```

## components/bluetooth/ac6955f/Kconfig
```kconfig
config BR2_PACKAGE_AC6955F
	bool "BT AC6955F"
	help
	  Bluetooth ac6955f module api
```

## components/bluetooth/ad6956f/Kconfig
```kconfig
config BR2_PACKAGE_AD6956F
	bool "BT AD6956F"
	help
	  Bluetooth ad6956f module api
```

## components/cmds/Kconfig
```kconfig
menuconfig BR2_PACKAGE_CMDS
	bool "Cmds"

if BR2_PACKAGE_CMDS
source "source/Kconfig"
endif
```

## components/cmds/source/Kconfig
```kconfig
menuconfig CONFIG_CMDS_OS
	bool "OS operations"
	default n

if CONFIG_CMDS_OS
source "os/Kconfig"
endif

config CONFIG_CMDS_PTHREAD
	bool "pthread operations"
	depends on BR2_PACKAGE_PTHREAD
	default n

menuconfig CONFIG_CMDS_NSH
	bool "Nsh operations"
	default n

if CONFIG_CMDS_NSH
source "third_party/nuttx/apps/nshlib/Kconfig"
endif

menuconfig CONFIG_CMDS_SOUND_TEST
	bool "sound test operations"
	default n

if CONFIG_CMDS_SOUND_TEST
source "sound_test/Kconfig"
endif

config CONFIG_CMDS_LSMOD
	bool "lsmod operations"
	default y

menuconfig CONFIG_CMDS_ADC_TEST
	bool "adc test operations"
	default n

if CONFIG_CMDS_ADC_TEST
source "saradc/Kconfig"
endif

config CONFIG_CMDS_FB_TEST
	bool "fb test operations"
	default n

config CONFIG_CMDS_INPUT
	bool "input event operations"
	depends on CONFIG_DRV_INPUT
	default n

config CONFIG_CMDS_MTD
	bool "mtd operations"
	depends on CONFIG_MTD
	default n

config CONFIG_CMDS_SPI
	bool "spi operations"
	depends on CONFIG_HC_SPI_SF || CONFIG_HC_SPI_MASTER
	default n

if CONFIG_CMDS_SPI
	choice
        prompt "Test spi controller"
	default TEST_SPI_SF

        config TEST_SPI_SF
                bool "test spi-sf"
        config TEST_SPI_MASTER
                bool "test spi-master"
	config TEST_SPI_GPIO
		bool "test spi-gpio"

	endchoice
endif

config CONFIG_CMDS_PERSISTENTMEM
	bool "persistent memory operations"
	depends on CONFIG_DRV_PERSISTENTMEM
	default n

config CONFIG_CMDS_POK_TEST
	bool "pok test operations"
	default n  

config CONFIG_CMD_UART
	bool "uart test operations"
	default n

config CONFIG_CMDS_WATCHDOG_TEST
	bool "watchdog test operations"
	default n  

config CONFIG_CMDS_EFUSE_DUMP
	bool "Efuse bits dump operations"
	default n
	
menuconfig CONFIG_CMDS_HDMI_RX
	bool "hdmi rx test operations"
	default n

if CONFIG_CMDS_HDMI_RX
config CONFIG_CMDS_HDMI_RX_SORTING
	bool "enable hdmrx sorting test"
	default n
endif

	
config CONFIG_CMDS_TV_DECODER
	bool "tv decoder(cvbs in) test operations"
	default n

config CONFIG_CMDS_PQ
	bool "PQ test operations"
	default n

config CONFIG_CMDS_HCFOTA
	bool "HCFOTA test operations"
	select BR2_PACKAGE_HCFOTA
	default n

config CONFIG_CMDS_STANDBY
	bool "standby test operations"
	default n

config CONFIG_CMDS_BLUETOOTH_TEST
	bool "config bluetooth test"
	default n

config CONFIG_CMDS_WS2811
	bool "ws2811 test operations"
	select BR2_PACKAGE_PREBUILTS_LIBWS2811
	default n

config CONFIG_CMDS_SORTING
       bool "sorting test operations"
       select BR2_PACKAGE_PREBUILTS_LIBSORTING
       default n

menuconfig CONFIG_CMDS_USB
	bool "USB setting operations"
	default n

if CONFIG_CMDS_USB
config CONFIG_CMDS_USB_GADGET_MSC
	bool "USB gadget: mass-storage device commonds"
	depends on BR2_PACKAGE_PREBUILTS_USBGADGETDRIVER
	depends on BR2_PACKAGE_PREBUILTS_USBGADGETDRIVER_MSC
	depends on CONFIG_CMDS_USB
	default n

config CONFIG_CMDS_USB_GADGET_NCM
	bool "USB gadget: NCM device commonds"
	depends on BR2_PACKAGE_PREBUILTS_USBGADGETDRIVER
	depends on BR2_PACKAGE_PREBUILTS_USBGADGETDRIVER_NCM
	depends on CONFIG_CMDS_USB
	default n

config CONFIG_CMDS_USB_GADGET_SERIAL
	bool "USB gadget: Serial device commonds"
	depends on BR2_PACKAGE_PREBUILTS_USBGADGETDRIVER
	depends on BR2_PACKAGE_PREBUILTS_USBGADGETDRIVER_SERIAL
	depends on CONFIG_CMDS_USB
	default n

config CONFIG_CMDS_USB_GADGET_ZERO
	bool "USB gadget: Zero demo"
	depends on BR2_PACKAGE_PREBUILTS_USBGADGETDRIVER
	depends on CONFIG_USB_ZERO
	depends on CONFIG_CMDS_USB
	default n

config CONFIG_CMDS_USB_GADGET_HID
	bool "USB gadget: HID device commonds"
	depends on BR2_PACKAGE_PREBUILTS_USBGADGETDRIVER
	depends on BR2_PACKAGE_PREBUILTS_USBGADGETDRIVER_HID
	depends on CONFIG_CMDS_USB
	default n
endif


config CONFIG_CMDS_LIBUSB_EXAMPLES
	bool "USB: libusb examples"	
	depends on CONFIG_CMDS_USB
	depends on BR2_PACKAGE_LIBUSB
	default n

config CONFIG_CMDS_USB_EYE_PATTERN
	bool "USB: Oscilloscope test eye pattern"	
	depends on CONFIG_CMDS_USB
	default n

config CONFIG_CMDS_USB_HID
	bool "USB: HID class test demos"	
	depends on BR2_PACKAGE_PREBUILTS_USBDRIVER_HID
	depends on CONFIG_CMDS_USB
	default n
	
config CONFIG_CMDS_VIN_DVP
bool "vin dvp test operations"
default n

config CONFIG_CMDS_PWM
bool "pwm test"
default n

config CONFIG_CMDS_WIFI
	bool "wifi test"
	select BR2_PACKAGE_PREBUILTS_WPA_SUPPLICANT
	select BR2_PACKAGE_PREBUILTS_WIFI_WIRELESS_TOOLS
	default n

config CONFIG_CMD_NETWORK
	bool "Network test commands"
	default n
	depends on BR2_PACKAGE_LIBCURL

config CONFIG_CMD_MIPI_TEST
	bool "MIPI test commands"
	default n
	depends on CONFIG_DRV_MIPI

menuconfig CONFIG_CMD_UNITY
        bool "Unity test entry"
	depends on BR2_PACKAGE_UNITY
	default n

if CONFIG_CMD_UNITY
config CONFIG_CMD_UNITY_DUMMY_CASES
        bool "Dummy unity test cases"
	default n
endif
```

## components/cmds/source/os/Kconfig
```kconfig
config CONFIG_CMDS_OS_TOP
	bool "top"
	default n

config CONFIG_CMDS_OS_PS
	bool "ps"
	default n
```

## components/cmds/source/saradc/Kconfig
```kconfig
config CONFIG_CMDS_TOUCH_ADC_TEST
	bool "touch adc test cmds"
	default n

config CONFIG_CMDS_KEY_ADC_TEST
	bool "key adc test cmds"
	default n

config CONFIG_CMDS_QUERY_ADC_TEST
	bool "query adc test cmds"
	default n
```

## components/cmds/source/third_party/nuttx/apps/nshlib/Kconfig
```kconfig
#
# For a description of the syntax of this configuration file,
# see the file kconfig-language.txt in the NuttX tools repository.
#
menu "Disable Individual commands"

config CONFIG_NSH_CMD_MODE_ALL
	bool "Command mode All"
	default n

config CONFIG_NSH_DISABLE_CAT
	bool "Disable cat"
	default n

config CONFIG_NSH_DISABLE_CD
	bool "Disable cd"
	default n

config CONFIG_NSH_DISABLE_CP
	bool "Disable cp"
	default n

config CONFIG_NSH_DISABLE_CMP
	bool "Disable cmp"
	default n

config CONFIG_NSH_DISABLE_DATE
	bool "Disable date"
	default n

config CONFIG_NSH_DISABLE_DD
	bool "Disable dd"
	default n

config CONFIG_NSH_DISABLE_DF
	bool "Disable df"
	default n

config CONFIG_NSH_DISABLE_DIRNAME
	bool "Disable dirname"
	default n

config CONFIG_NSH_DISABLE_ECHO
	bool "Disable echo"
	default n

config CONFIG_NSH_DISABLE_HEXDUMP
	bool "Disable hexdump"
	default n

config CONFIG_NSH_DISABLE_LS
	bool "Disable ls"
	default n

config CONFIG_NSH_DISABLE_MB
	bool "Disable mb"
	default n

config CONFIG_NSH_DISABLE_MKDIR
	bool "Disable mkdir"
	default n

config CONFIG_NSH_DISABLE_MKFATFS
	bool "Disable mkfatfs"
	depends on CONFIG_FSUTILS_MKFATFS

menuconfig CONFIG_NSH_DISABLE_ROMFSTEST
	bool "Disable romfstest"
	default y

if !CONFIG_NSH_DISABLE_ROMFSTEST
	config CONFIG_NSH_ROMFS_IMAGEFILE
	string "Romfs imagefile"

	config CONFIG_NSH_ROMFS_DEV_MINOR
	int "Romfs dev minor"
	default 1

	config CONFIG_NSH_ROMFS_MOUNTPOINT
	string "Romfs mountpoing"
	default "/romfs"
endif

config CONFIG_NSH_DISABLE_MKRD
        bool "Disable mkrd"
	default n

config CONFIG_NSH_DISABLE_MH
	bool "Disable mh"
	default n

config CONFIG_NSH_DISABLE_MOUNT
	bool "Disable mount"
	default n

config CONFIG_NSH_DISABLE_MV
	bool "Disable mv"
	default n

config CONFIG_NSH_DISABLE_MW
	bool "Disable mw"
	default n

config CONFIG_NSH_DISABLE_PWD
	bool "Disable pwd"
	default n

config CONFIG_NSH_DISABLE_RM
	bool "Disable rm"
	default n

config CONFIG_NSH_DISABLE_RMDIR
	bool "Disable rmdir"
	default n

config CONFIG_NSH_DISABLE_TIME
	bool "Disable time"
	default n

config CONFIG_NSH_DISABLE_TRUNCATE
	bool "Disable truncate"
	default y

config CONFIG_NSH_DISABLE_UMOUNT
	bool "Disable umount"
	default n

config CONFIG_NSH_DISABLE_XD
	bool "Disable xd"
	default y if DEFAULT_SMALL
	default n if !DEFAULT_SMALL

endmenu

menu "Configure Command Options"

config CONFIG_NSH_CMDOPT_DD_STATS
	bool "dd: Support transfer statistics"
	default n
	depends on !CONFIG_NSH_DISABLE_DD

config CONFIG_NSH_CMDOPT_HEXDUMP
	bool "hexdump: Enable 'skip' and 'count' parameters"
	default y
	depends on !CONFIG_NSH_DISABLE_HEXDUMP

endmenu

config CONFIG_NSH_FILEIOSIZE
	int "NSH I/O buffer size"
	default 1024
	---help---
		Size of a static I/O buffer used for file access (ignored if
		there is no filesystem). Default is 512/1024.
```

## components/ffmpeg/Kconfig
```kconfig
config BR2_PACKAGE_FFMPEG_ARCH_SUPPORTS
	bool
	default y
	# fenv.h lacks FE_INVALID, FE_OVERFLOW & FE_UNDERFLOW on nios2
	depends on !BR2_nios2
	# No support for ARMv7-M in the ARM assembly logic
	depends on !BR2_ARM_CPU_ARMV7M
	# m68k coldfire causes a build failure, because the check for
	# atomics (atomic_store) succeeds, which causes ffmpeg to
	# think atomic intrinsics are available, while they are
	# not. See https://patchwork.ozlabs.org/patch/756664/ and
	# https://gcc.gnu.org/bugzilla/show_bug.cgi?id=68467 for more
	# details.
	depends on !BR2_m68k_cf
	# assertion fail in binutils
	depends on !(BR2_or1k && !BR2_TOOLCHAIN_GCC_AT_LEAST_9)

menuconfig BR2_PACKAGE_FFMPEG
	bool "ffmpeg"
	depends on BR2_PACKAGE_FFMPEG_ARCH_SUPPORTS
	select CONFIG_LIB_GZIP
	help
	  FFmpeg is a complete, cross-platform solution to record,
	  convert and stream audio and video.

	  http://www.ffmpeg.org

if BR2_PACKAGE_FFMPEG

config BR2_PACKAGE_FFMPEG_GPL
	bool "Enable GPL code"
	help
	  allow use of GPL code, the resulting libs and binaries will
	  be under GPL

config BR2_PACKAGE_FFMPEG_NONFREE
	bool "Enable nonfree code"
	help
	  allow use of nonfree code, the resulting libs and binaries
	  will be unredistributable

config BR2_PACKAGE_FFMPEG_FFMPEG
	bool "Build ffmpeg (the command line application)"
	default y
	help
	  FFmpeg is a very fast video and audio converter.
	  It can also grab from a live audio/video source.

	  It is not needed if you want to link the FFmpeg libraries
	  to your application.

config BR2_PACKAGE_FFMPEG_FFPLAY
	bool "Build ffplay"
	depends on !BR2_STATIC_LIBS # sdl2
	select BR2_PACKAGE_FFMPEG_SWSCALE
	select BR2_PACKAGE_SDL2
	help
	  FFplay is a very simple and portable media player using the
	  FFmpeg libraries and the SDL library.
	  It is mostly used as a testbed for the various FFmpeg APIs.

comment "ffplay needs a toolchain w/ dynamic library"
	depends on BR2_STATIC_LIBS

config BR2_PACKAGE_FFMPEG_FFPROBE
	bool "Build ffprobe"
	help
	  FFprobe is a utility to determine the audio and video
	  characteristics of a container file.

config BR2_PACKAGE_FFMPEG_XCBGRAB
	bool "Build X11 screen grabbing"
	depends on BR2_PACKAGE_XORG7
	select BR2_PACKAGE_LIBXCB
	help
	  X11 screen grabbing using libxcb.

config BR2_PACKAGE_FFMPEG_AVRESAMPLE
	bool "Build libavresample"
	help
	  Avresample is a audio conversion library for compatibility.

config BR2_PACKAGE_FFMPEG_POSTPROC
	bool "Build libpostproc"
	depends on BR2_PACKAGE_FFMPEG_GPL
	help
	  Postproc is a library of video postprocessing routines.

config BR2_PACKAGE_FFMPEG_SWSCALE
	bool "Build libswscale"
	help
	  Swscale is a library of video scaling routines.

config BR2_PACKAGE_FFMPEG_ENCODERS
	string "Enabled encoders"
	default ""
	help
	  Space-separated list of encoders to build in FFmpeg,
	  or "all" to build all of them.

	  Run ./configure --list-encoders in the ffmpeg sources
	  directory to know the available options.

config BR2_PACKAGE_FFMPEG_DECODERS
	string "Enabled decoders"
	default ""
	help
	  Space-separated list of decoders to build in FFmpeg,
	  or "all" to build all of them.

	  Run ./configure --list-decoders in the ffmpeg sources
	  directory to know the available options.

config BR2_PACKAGE_FFMPEG_MUXERS
	string "Enabled muxers"
	default ""
	help
	  Space-separated list of muxers to build in FFmpeg,
	  or "all" to build all of them.

	  Run ./configure --list-muxers in the ffmpeg sources
	  directory to know the available options.

config BR2_PACKAGE_FFMPEG_DEMUXERS
	string "Enabled demuxers"
	default "mp3 aac ac3 avi asf amr ape amrnb amrwb dts dvbsub dvbtxt eac3 flac flv h261 h263 h264 hevc hls mjpeg m4v mov mpegps mpegts mpegtsraw mjpeg_2000 mpegvideo mpjpeg matroska ogg pcm_alaw pcm_f32be pcm_f32le pcm_f64be pcm_f64le pcm_mulaw pcm_s16be pcm_s16le pcm_s24be pcm_s24le pcm_s32be pcm_s32le pcm_s8 pcm_u16be pcm_u16le pcm_u24be pcm_u24le pcm_u32be pcm_u32le pcm_u8 rm rtp rtsp spdif wav"
	help
	  Space-separated list of demuxers to build in FFmpeg,
	  or "all" to build all of them.

	  Run ./configure --list-demuxers in the ffmpeg sources
	  directory to know the available options.

config BR2_PACKAGE_FFMPEG_PARSERS
	string "Enabled parsers"
	default "aac aac_latm ac3 flac gif h261 h263 h264 hevc jpeg2000 mjpeg mpeg4video mpegaudio mpegvideo opus vc1 vorbis"
	help
	  Space-separated list of parsers to build in FFmpeg,
	  or "all" to build all of them.

	  Run ./configure --list-parsers in the ffmpeg sources
	  directory to know the available options.

config BR2_PACKAGE_FFMPEG_BSFS
	string "Enabled bitstreams"
	default ""
	help
	  Space-separated list of bitstream filters to build in FFmpeg,
	  or "all" to build all of them.

	  Run ./configure --list-bsfs in the ffmpeg sources
	  directory to know the available options.

config BR2_PACKAGE_FFMPEG_PROTOCOLS
	string "Enabled protocols"
	default "file ftp data hls http httpproxy mmsh mmst rtmp rtmpt rtp tcp srtp udp"
	help
	  Space-separated list of protocols to build in FFmpeg,
	  or "all" to build all of them.

	  Run ./configure --list-protocols in the ffmpeg sources
	  directory to know the available options.

config BR2_PACKAGE_FFMPEG_FILTERS
	string "Enabled filters"
	default ""
	help
	  Space-separated list of filters to build in FFmpeg,
	  or "all" to build all of them.

	  Run ./configure --list-filters in the ffmpeg sources
	  directory to know the available options.

config BR2_PACKAGE_FFMPEG_INDEVS
	bool "Enable input devices"
	default n

config BR2_PACKAGE_FFMPEG_OUTDEVS
	bool "Enable output devices"
	default n

config BR2_PACKAGE_FFMPEG_EXTRACONF
	string "Additional parameters for ./configure"
	default "--disable-decklink --disable-avfilter --disable-avdevice --disable-swresample --disable-fft --disable-doc --disable-hwaccels"
	help
	  Extra parameters that will be appended to FFmpeg's
	  ./configure commandline.

config BR2_PACKAGE_FFMPEG_GDB_DBG
	bool "enable ffmpeg gdb debug"
	default n
endif
```

## components/freetype/Kconfig
```kconfig
config BR2_PACKAGE_FREETYPE
	bool "freetype"
	default n
	help
	  a free, high-quality and portable font engine.

	  https://www.freetype.org/
```

## components/hc-examples/Kconfig
```kconfig
config BR2_PACKAGE_HC_EXAMPLES
	bool "hc-examples"
	default n

if BR2_PACKAGE_HC_EXAMPLES
config BR2_PACKAGE_HDMI_WIREELSS_EXAMPLE
	bool "hdmi wireless example"
	default n
	select CONFIG_NET

if BR2_PACKAGE_HDMI_WIREELSS_EXAMPLE
choice
	bool "hdmi wireless sample sending data way"
	default BR2_PACKAGE_HDMI_WIRELSS_DISPLAY_RAW

config BR2_PACKAGE_HDMI_WIRELSS_DISPLAY_RAW
	bool "Calling netowork driver api directly"

config BR2_PACKAGE_HDMI_WIRELSS_DISPLAY_TCP
	bool "Using tcp"

config BR2_PACKAGE_HDMI_WIRELSS_DISPLAY_UDP
	bool "Using udp"

endchoice
endif
endif
```
