## components/hclib/libntfs/Kconfig
```kconfig
menuconfig BR2_PACKAGE_LIBNTFS
	bool "libntfs"
	select BR2_PACKAGE_PREBUILTS_NTFS
	default n

if BR2_PACKAGE_LIBNTFS

config CONFIG_LIBNTFS_DEBUG
	bool "Enable debug"
	default n

endif
```

## components/hclib/libtoe/Kconfig
```kconfig
menuconfig BR2_PACKAGE_LIBTOE
	bool "libtoe"
	select BR2_PACKAGE_PREBUILTS_TOE
	default n
```

## components/hclib/mipidriver/Kconfig
```kconfig
menuconfig BR2_PACKAGE_MIPIDRIVER
	bool "mipi driver"
	default n

if BR2_PACKAGE_MIPIDRIVER
config CONFIG_MIPIDRIVER_DEBUG
	bool "Enable debug"
	default n
endif
```

## components/hclib/rtl8188eu/Kconfig
```kconfig
config BR2_PACKAGE_RTL8188EU
	bool "rtl8188eu wifi"
	depends on CONFIG_NET
	select CONFIG_DRV_LNXDRIVER
	select CONFIG_DRV_SOFTIRQ
	default n
```

## components/hclib/rtl8188fu/Kconfig
```kconfig
config BR2_PACKAGE_RTL8188FU
	bool "rtl8188fu wifi"
	depends on CONFIG_NET
	select CONFIG_DRV_LNXDRIVER
	select CONFIG_DRV_SOFTIRQ
	default n
```

## components/hclib/rtl8733bu/Kconfig
```kconfig
config BR2_PACKAGE_RTL8733BU
	bool "rtl8733bu wifi"
	depends on CONFIG_NET
	select CONFIG_DRV_LNXDRIVER
	select CONFIG_DRV_SOFTIRQ
	default n
```

## components/hclib/rtl8811cu/Kconfig
```kconfig
config BR2_PACKAGE_RTL8811CU
	bool "rtl8811cu wifi"
	depends on CONFIG_NET
	select CONFIG_DRV_LNXDRIVER
	select CONFIG_DRV_SOFTIRQ
	default n
```

## components/hclib/viddriver/Kconfig
```kconfig
menuconfig BR2_PACKAGE_VIDDRIVER
	bool "video driver"
	default n
	select CONFIG_I2C
	select CONFIG_I2C_SLAVE

if BR2_PACKAGE_VIDDRIVER

config CONFIG_VIDDRIVER_OSAL_HSR_NWORKS
	int "Maximum parallel osal HSR works"
	default 48

config CONFIG_VIDDRIVER_DEBUG
	bool "Enable debug"
	default n

config CONFIG_VIDDRIVER_FULL
	bool "full video driver support"
	default y

if !CONFIG_VIDDRIVER_FULL
choice
	prompt "decoder select"
	default CONFIG_VIDDRIVER_DECODER_MPEG2

config CONFIG_VIDDRIVER_DECODER_MPEG2
	bool "Enable mpeg2 decoder support"

config CONFIG_VIDDRIVER_DECODER_MJPEG
	bool "Enable mjpeg decoder support"
endchoice
endif
endif
```

## components/hclib/wpa_supplicant/Config.in
```kconfig
menuconfig BR2_PACKAGE_WPA_SUPPLICANT
	bool "wpa_supplicant"
	select CONFIG_NET
	select CONFIG_DEV_URANDOM
	help
	  WPA supplicant for secure wireless networks

	  http://w1.fi/wpa_supplicant/


if BR2_PACKAGE_WPA_SUPPLICANT
choice
	prompt "select wpa_supplicant version"
	default BR2_PACKAGE_WPA_SUPPLICANT_RTL_V2_7
	help
	  select wpa_supplicant version

config BR2_PACKAGE_WPA_SUPPLICANT_RTL_V0_8
	bool "wpa_supplicant 0.8 provied by Realtek"
	help
	  select wpa_supplicant 0.8

config BR2_PACKAGE_WPA_SUPPLICANT_RTL_V2_7
	bool "wpa_supplicant 2.7 provied by Realtek"
	#select BR2_LIBNL_V1
	help
	  select wpa_supplicant 2.0

endchoice

if BR2_PACKAGE_WPA_SUPPLICANT_RTL_V2
source wpa_supplicant-rtl/wpa_supplicant/Config.in
endif

endif
```

## components/kernel/Kconfig
```kconfig
menuconfig BR2_PACKAGE_KERNEL
	bool "kernel"
	select BR2_PACKAGE_NEWLIB

if BR2_PACKAGE_KERNEL
source "source/Kconfig"
endif
```

## components/kernel/source/Kconfig
```kconfig
source "arch/Kconfig"
source "freertos/Kconfig"
source "fs/Kconfig"
source "lib/Kconfig"
source "drivers/Kconfig"
source "sound/Kconfig"
source "net/Kconfig"
source "dts/Kconfig"
```

## components/kernel/source/arch/Kconfig
```kconfig
config CONFIG_SYS_ARCH
	string
	help
	  This option should contain the architecture name to build the
	  appropriate arch/<CONFIG_SYS_ARCH> directory.
	  All the architectures should specify this option correctly.

config CONFIG_SYS_CPU
	string
	help
	  This option should contain the CPU name to build the correct
	  arch/<CONFIG_SYS_ARCH>/<CONFIG_SYS_CPU> directory.

	  This is optional.  For those targets without the CPU directory,
	  leave this option empty.

source "mips/Kconfig"
```

## components/kernel/source/arch/mips/Kconfig
```kconfig
menu "Architecture"

config CONFIG_SYS_ARCH
	default "mips" if CONFIG_CPU_MIPS32R1 || CONFIG_CPU_MIPS74KEF

config CONFIG_SYS_CPU
	default "mips32r1" if CONFIG_CPU_MIPS32R1
	default "mips74kef" if CONFIG_CPU_MIPS74KEF

choice
	prompt "CPU selection"
	default CONFIG_CPU_MIPS32R1

config CONFIG_CPU_MIPS32R1
	bool "MIPS32R1"
	help
	  Choose this option to build an for MIPS32R1 architecture.

config CONFIG_CPU_MIPS74KEF
	bool "MIPS74KEF"
	help
	  Choose this option to build an for MIPS74KEF architecture.

endchoice

config CONFIG_SYS_RST_WDT
	bool "hardware init hook IP reset watchdog"
	default n

endmenu
```

## components/kernel/source/drivers/Kconfig
```kconfig
menu "Drivers"

menuconfig CONFIG_DRV_UART
        bool "Uart driver"
        default y

if CONFIG_DRV_UART
source "uart/Kconfig"
endif

menuconfig CONFIG_DRV_VIRTUART
        bool "Virtual uart driver"
        default y

if CONFIG_DRV_VIRTUART
source "virtuart/Kconfig"
endif

menuconfig CONFIG_DRV_FILEUART
        bool "File uart driver"
        default n

if CONFIG_DRV_FILEUART
source "fileuart/Kconfig"
endif

config CONFIG_DRV_DUMMYUART
        bool "Dummy uart driver"
        default y

config CONFIG_DRV_DEVNULL
        bool "Enable /dev/null"
        default y

config CONFIG_DRV_DEVZERO
        bool "Enable /dev/zero"
        default n

config CONFIG_DRV_SOFTIRQ
        bool "Softirq support"
        default n

menuconfig CONFIG_DRV_LNXDRIVER
        bool "Lnx support"
        default n

if CONFIG_DRV_LNXDRIVER
config CONFIG_SCHED_LNXWORKSTACKSIZE
	hex "Default lnx work stack size in uint32_t"
	default 0x1000

config CONFIG_SCHED_SOFTIRQD_HI_PRIORITY
	int "Default lnx softirqd hi task priority"
	default CONFIG_TASK_CRITICAL_PRIORITY

menuconfig CONFIG_SCHED_SOFTIRQD_HI_RESCHED
	bool "Enable softirqd hi task resched"
	default y

if CONFIG_SCHED_SOFTIRQD_HI_RESCHED
config CONFIG_SCHED_SOFTIRQD_HI_RESCHED_PRIORITY
	int "Default lnx softirqd hi task resched priority"
	default CONFIG_TASK_CRITICAL_PRIORITY
endif

config CONFIG_SCHED_SOFTIRQD_PRIORITY
	int "Default lnx softirqd task priority"
	default CONFIG_TASK_CRITICAL_PRIORITY

menuconfig CONFIG_SCHED_SOFTIRQD_RESCHED
	bool "Enable softirqd task resched"
	default y

if CONFIG_SCHED_SOFTIRQD_RESCHED
config CONFIG_SCHED_SOFTIRQD_RESCHED_PRIORITY
	int "Default lnx softirqd task resched priority"
	default CONFIG_TASK_CRITICAL_PRIORITY
endif

config CONFIG_NET_RX_SOFTIRQ_IN_TASK_ONLY
	bool "net rx softirq process in task only"
	default n

config CONFIG_NET_TX_SOFTIRQ_IN_TASK_ONLY
	bool "net tx softirq process in task only"
	default n

config CONFIG_TASKLET_SOFTIRQ2_IN_TASK_ONLY
	bool "tasklet softirq process in task only"
	default n
endif

menuconfig CONFIG_DRV_WQUEUE
        bool "Workqueue support"
        default y

if CONFIG_DRV_WQUEUE
source "wqueue/Kconfig"
endif

menuconfig CONFIG_DRV_AMPRPC
        bool "AMP RPC support"
	select CONFIG_SCHED_RPCWORK
	select CONFIG_SCHED_HPWORK
	select CONFIG_WQUEUE_NOTIFIER
	depends on CONFIG_SOC_HC16XX
        default n

if CONFIG_DRV_AMPRPC
source "amprpc/Kconfig"
endif

config CONFIG_DRVR_RAMDISK
	bool "Ramdisk"
	default n

config CONFIG_DRVR_MKRD
	bool "RAM disk wrapper (mkrd)"
	default n
	---help---
		Build the mkrd() function which serves as a wrapper to simplify
		creation of RAM disks.  If the boardctrl() interface is enabled,
		the selecting this option will also enable the BOARDIOC_MKRD
		command that will support creation of RAM disks from applications.

source "bch/Kconfig"

source "mtd/Kconfig"

source "pipes/Kconfig"

menu "Buffering"

config CONFIG_DRVR_WRITEBUFFER
	bool "Enable write buffer support"
	default n
	---help---
		Enable generic write buffering support that can be used by a variety
		of drivers.

if CONFIG_DRVR_WRITEBUFFER

config CONFIG_DRVR_WRDELAY
	int "Write flush delay"
	default 350
	---help---
		If there is no write activity for this configured amount of time,
		then the contents will be automatically flushed to the media.  This
		reduces the likelihood that data will be stuck in the write buffer
		at the time of power down.

endif # CONFIG_DRVR_WRITEBUFFER

config CONFIG_DRVR_READAHEAD
	bool "Enable read-ahead buffer support"
	default n
	---help---
		Enable generic read-ahead buffering support that can be used by a
		variety of drivers.

if CONFIG_DRVR_WRITEBUFFER || CONFIG_DRVR_READAHEAD

config CONFIG_DRVR_READBYTES
	bool "Support byte read method"
	default y if CONFIG_MTD_BYTE_WRITE
	default n if !CONFIG_MTD_BYTE_WRITE

config CONFIG_DRVR_REMOVABLE
	bool "Support removable media"
	default n

config CONFIG_DRVR_INVALIDATE
	bool "Support cache invalidation"
	default n

endif # CONFIG_DRVR_WRITEBUFFER || CONFIG_DRVR_READAHEAD

endmenu # Buffering

config CONFIG_DEV_MMZ
	bool "mmz dev"
	default y

menuconfig CONFIG_DRV_VIDEO
	bool "video"
	default n

if CONFIG_DRV_VIDEO
source "video/Kconfig"
endif


config CONFIG_DRV_PINMUX
	bool "pinmux"
	default y

config CONFIG_DRV_GPIO
	bool "gpio"
	default y

config CONFIG_DRV_ADC
	bool "ADC Support"
	default n
	
source "av/Kconfig"

config CONFIG_DRV_POK
	bool "pok Support"
	default n

menuconfig CONFIG_DRV_INPUT
	bool "input event"
	default y

if CONFIG_DRV_INPUT
source "input/Kconfig"
endif

menuconfig CONFIG_DRV_SPI
	bool "spi support"
	default y

if CONFIG_DRV_SPI
source "spi/Kconfig"
endif

config CONFIG_DRV_LVDS
	bool "lvds"
	depends on CONFIG_SOC_HC16XX
	default n

config CONFIG_DRV_RGB
	bool "rgb"
	depends on CONFIG_SOC_HC15XX
	default n

config CONFIG_DRV_MIPI
	bool "mipi"
	depends on CONFIG_SOC_HC16XX
	default y

source "i2c/Kconfig"

source "pwm/Kconfig"

config CONFIG_DRV_NBDBG
	bool "NB debug"
	default y

menuconfig CONFIG_DRV_APLATFORM
	bool "audio platform support"
	default y

if CONFIG_DRV_APLATFORM
source "aplatform/Kconfig"
endif

menuconfig CONFIG_DRV_WDT
	bool "watchdog"
	default n

if CONFIG_DRV_WDT
	source "watchdog/Kconfig"
endif

config CONFIG_DRV_PERSISTENTMEM
	bool "persistent memory"
	select CONFIG_LIB_CRC
	select CONFIG_MTD_BYTE_WRITE
	default y

config CONFIG_DRV_HWSPINLOCK
        bool "hwspinlock"
        default n

menuconfig CONFIG_DRV_KSHM
	bool "kshm driver"
	select CONFIG_DRV_HWSPINLOCK
	default y

if CONFIG_DRV_KSHM
config CONFIG_DRV_KSHM_FOR_DUALCORE
	bool "kshm for dualcore"
	default n
endif

config CONFIG_DRV_HCGE
	bool "hcge driver"
	default n

menuconfig CONFIG_DRV_STANDBY
        bool "standby driver"
        default n

if CONFIG_DRV_STANDBY
config CONFIG_OUT_HC_SCANCODE
        bool "output hichip scancode"
        default n
#config CONFIG_STANDBY_REAL_MODE
#       bool "standby fast mode"
#       default n
endif
	
menuconfig CONFIG_DRV_DVP
	bool "dvp driver"
	default n

if CONFIG_DRV_DVP
source "dvp/Kconfig"
endif

source "crypto/Kconfig"

menuconfig CONFIG_USB_GADGET_VENDOR
	bool "USB gadget vendor support"
	default n

if CONFIG_USB_GADGET_VENDOR
	config CONFIG_USB_ZERO
		bool "usb gadget demo: zero"
		default n
endif

if CONFIG_USB_GADGET_VENDOR
	config CONFIG_USB_GADGET_HID_VENDOR
		bool "usb gadget demo: hid mouse/keyboard report parameters"
		default n
endif
 
menuconfig CONFIG_DRV_LCD
	bool "lcd driver"
	default n

if CONFIG_DRV_LCD
source lcd/Kconfig"
endif

endmenu
```

## components/kernel/source/drivers/adc/Kconfig
```kconfig
config CONFIG_DRV_ADC
	bool "init SAR ADC module"
	depends on CONFIG_SOC_HC15XX
	default y
```

## components/kernel/source/drivers/amprpc/Kconfig
```kconfig
config CONFIG_RPCMSG_NUM
	int "RPC message number"
        default 8
	---help---
		The message number of RPC. Each RPC call
		requires one message to store the RPC parameters.

config CONFIG_RPCMSG_SIZE
	int "RPC message buffer size"
	default 4096
	---help---
		The message buffer size.

config CONFIG_RPCWORK_NUM
	int "RPC works number"
	default 64
	---help---
		The RPC works number.
```

## components/kernel/source/drivers/av/Kconfig
```kconfig
menuconfig CONFIG_AUDIO_SUPPORT
	bool "Audio Support"
	default y

if CONFIG_AUDIO_SUPPORT
config CONFIG_AUDIO_I2SO_SUPPORT
	bool "i2so Support"
	default y

config CONFIG_AUDIO_I2SI_SUPPORT
	bool "i2si Support"
	default y

config CONFIG_AUDIO_I2SI0_SUPPORT
	bool "i2si0 Support"
	default n

config CONFIG_AUDIO_I2SI1_SUPPORT
	bool "i2si1 Support"
	default n

config CONFIG_AUDIO_I2SI2_SUPPORT
	bool "i2si2 Support"
	default n

config CONFIG_AUDIO_SPO_SUPPORT
	bool "spo Support"
	default y

config CONFIG_AUDIO_SPIN_SUPPORT
	bool "spin Support"
	default y

config CONFIG_AUDIO_PCMO_SUPPORT
	bool "pcmo Support"
	default n

config CONFIG_AUDIO_PCMI_SUPPORT
	bool "pcmi Support"
	default n

config CONFIG_AUDIO_PCMI0_SUPPORT
	bool "pcmi0 Support"
	default n

config CONFIG_AUDIO_PCMI1_SUPPORT
	bool "pcmi1 Support"
	default n

config CONFIG_AUDIO_PCMI2_SUPPORT
	bool "pcmi2 Support"
	default n

config CONFIG_AUDIO_PDMI0_SUPPORT
	bool "pdmi0 Support"
	default n

config CONFIG_AUDIO_TDMI_SUPPORT
	bool "tdmi Support"
	default n
	depends on CONFIG_SOC_HC16XX

config CONFIG_AUDIO_DECODER_PRIORITY
	int "Default audio decoder task priority"
	default CONFIG_TASK_HIGH_PRIORITY

config CONFIG_AUDIO_DECODER_STACKSIZE
	hex "Default audio decoder task stack size"
	default 0x4000

config CONFIG_AUDIO_SINK_PRIORITY
	int "Default audio sink task priority"
	default CONFIG_TASK_HIGH_PRIORITY

config CONFIG_AUDIO_SINK_STACKSIZE
	hex "Default audio sink task stack size"
	default 0x400
endif

menuconfig CONFIG_VIDEO_SUPPORT
	bool "Video Support"
	default y

if CONFIG_VIDEO_SUPPORT
config CONFIG_VIDEO_HDMI_TX_SUPPORT
	bool "hdmi tx Support"
	default y

config CONFIG_VIDEO_HDMI_RX_SUPPORT
	bool "hdmi rx Support"
	select CONFIG_I2C
	select CONFIG_I2C_SLAVE
	select CONFIG_I2C_SLAVE_HDMI
	depends on CONFIG_SOC_HC16XX

config CONFIG_VIDEO_VINDVP_SUPPORT
	bool "vin dvp Support"
	default y

config CONFIG_VIDEO_TVDECODER_SUPPORT
	bool "tv decoder Support"
	default y

config CONFIG_VIDEO_DECODER_SUPPORT
	bool "video decoder Support"
	default y
config CONFIG_VIDEO_SINK_SUPPORT
	bool "video sink Support"
	default y
	select BR2_PACKAGE_PREBUILTS_IMAGEDEC

config CONFIG_PQ_SUPPORT
	bool "PQ Support"
	default y if CONFIG_SOC_HC16XX
	default n if CONFIG_SOC_HC15XX
endif

config CONFIG_AVSYNC_SUPPORT
	bool "avsync dev Support"
	default y
```
